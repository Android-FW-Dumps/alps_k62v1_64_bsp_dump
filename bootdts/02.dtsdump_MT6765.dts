/dts-v1/;

/ {
	model = "MT6765";
	compatible = "mediatek,MT6765";
	interrupt-parent = <0x01>;
	#address-cells = <0x02>;
	#size-cells = <0x02>;

	chosen {
		bootargs = "console=tty0 console=ttyS0,921600n1 vmalloc=400M slub_debug=OFZPU page_owner=on swiotlb=noforce androidboot.hardware=mt6765 maxcpus=8 loop.max_part=7 firmware_class.path=/vendor/firmware";
		kaslr-seed = <0x00 0x00>;
		linux,phandle = <0x4c>;
		phandle = <0x4c>;
	};

	cpus {
		#address-cells = <0x01>;
		#size-cells = <0x00>;

		cpu@000 {
			device_type = "cpu";
			compatible = "arm,cortex-a53";
			reg = <0x00>;
			enable-method = "psci";
			clock-frequency = <0x89267940>;
			cpu-idle-states = <0x02 0x03 0x04 0x05 0x06 0x07 0x08>;
			linux,phandle = <0x09>;
			phandle = <0x09>;
		};

		cpu@001 {
			device_type = "cpu";
			compatible = "arm,cortex-a53";
			reg = <0x01>;
			enable-method = "psci";
			clock-frequency = <0x89267940>;
			cpu-idle-states = <0x02 0x03 0x04 0x05 0x06 0x07 0x08>;
			linux,phandle = <0x0a>;
			phandle = <0x0a>;
		};

		cpu@002 {
			device_type = "cpu";
			compatible = "arm,cortex-a53";
			reg = <0x02>;
			enable-method = "psci";
			clock-frequency = <0x89267940>;
			cpu-idle-states = <0x02 0x03 0x04 0x05 0x06 0x07 0x08>;
			linux,phandle = <0x0b>;
			phandle = <0x0b>;
		};

		cpu@003 {
			device_type = "cpu";
			compatible = "arm,cortex-a53";
			reg = <0x03>;
			enable-method = "psci";
			clock-frequency = <0x89267940>;
			cpu-idle-states = <0x02 0x03 0x04 0x05 0x06 0x07 0x08>;
			linux,phandle = <0x0c>;
			phandle = <0x0c>;
		};

		cpu@100 {
			device_type = "cpu";
			compatible = "arm,cortex-a53";
			reg = <0x100>;
			enable-method = "psci";
			clock-frequency = <0x6b49d200>;
			cpu-idle-states = <0x02 0x03 0x04 0x05 0x06 0x07 0x08>;
			linux,phandle = <0x0d>;
			phandle = <0x0d>;
		};

		cpu@101 {
			device_type = "cpu";
			compatible = "arm,cortex-a53";
			reg = <0x101>;
			enable-method = "psci";
			clock-frequency = <0x6b49d200>;
			cpu-idle-states = <0x02 0x03 0x04 0x05 0x06 0x07 0x08>;
			linux,phandle = <0x0e>;
			phandle = <0x0e>;
		};

		cpu@102 {
			device_type = "cpu";
			compatible = "arm,cortex-a53";
			reg = <0x102>;
			enable-method = "psci";
			clock-frequency = <0x6b49d200>;
			cpu-idle-states = <0x02 0x03 0x04 0x05 0x06 0x07 0x08>;
			linux,phandle = <0x0f>;
			phandle = <0x0f>;
		};

		cpu@103 {
			device_type = "cpu";
			compatible = "arm,cortex-a53";
			reg = <0x103>;
			enable-method = "psci";
			clock-frequency = <0x6b49d200>;
			cpu-idle-states = <0x02 0x03 0x04 0x05 0x06 0x07 0x08>;
			linux,phandle = <0x10>;
			phandle = <0x10>;
		};

		cpu-map {

			cluster0 {

				core0 {
					cpu = <0x09>;
				};

				core1 {
					cpu = <0x0a>;
				};

				core2 {
					cpu = <0x0b>;
				};

				core3 {
					cpu = <0x0c>;
				};
			};

			cluster1 {

				core0 {
					cpu = <0x0d>;
				};

				core1 {
					cpu = <0x0e>;
				};

				core2 {
					cpu = <0x0f>;
				};

				core3 {
					cpu = <0x10>;
				};
			};
		};

		idle-states {
			entry-method = "arm,psci";

			standby {
				compatible = "arm,idle-state";
				arm,psci-suspend-param = <0x01>;
				entry-latency-us = <0x258>;
				exit-latency-us = <0x258>;
				min-residency-us = <0x4b0>;
				linux,phandle = <0x02>;
				phandle = <0x02>;
			};

			mcdi-cpu {
				compatible = "arm,idle-state";
				arm,psci-suspend-param = <0x10001>;
				entry-latency-us = <0x258>;
				exit-latency-us = <0x258>;
				min-residency-us = <0x4b0>;
				linux,phandle = <0x03>;
				phandle = <0x03>;
			};

			mcdi-cluster {
				compatible = "arm,idle-state";
				arm,psci-suspend-param = <0x1010001>;
				entry-latency-us = <0x258>;
				exit-latency-us = <0x258>;
				min-residency-us = <0x4b0>;
				linux,phandle = <0x04>;
				phandle = <0x04>;
			};

			sodi {
				compatible = "arm,idle-state";
				arm,psci-suspend-param = <0x1010002>;
				entry-latency-us = <0x320>;
				exit-latency-us = <0x3e8>;
				min-residency-us = <0x7d0>;
				linux,phandle = <0x05>;
				phandle = <0x05>;
			};

			sodi3 {
				compatible = "arm,idle-state";
				arm,psci-suspend-param = <0x1010003>;
				entry-latency-us = <0x320>;
				exit-latency-us = <0x3e8>;
				min-residency-us = <0x7d0>;
				linux,phandle = <0x06>;
				phandle = <0x06>;
			};

			dpidle {
				compatible = "arm,idle-state";
				arm,psci-suspend-param = <0x1010004>;
				entry-latency-us = <0x320>;
				exit-latency-us = <0x3e8>;
				min-residency-us = <0x7d0>;
				linux,phandle = <0x07>;
				phandle = <0x07>;
			};

			suspend {
				compatible = "arm,idle-state";
				arm,psci-suspend-param = <0x1010005>;
				entry-latency-us = <0x320>;
				exit-latency-us = <0x3e8>;
				min-residency-us = <0x7d0>;
				linux,phandle = <0x08>;
				phandle = <0x08>;
			};
		};
	};

	psci {
		compatible = "arm,psci-1.0";
		method = "smc";
	};

	pmu {
		compatible = "arm,armv8-pmuv3";
		interrupt-parent = <0x11>;
		interrupts = <0x01 0x07 0x08>;
	};

	l2c_parity {
		compatible = "mediatek,l2c_parity-v1";
		interrupts = <0x00 0x18 0x04 0x00 0x19 0x04>;
	};

	memory {
		device_type = "memory";
		reg = <0x00 0x40000000 0x00 0x20000000>;
	};

	reserved-memory {
		#address-cells = <0x02>;
		#size-cells = <0x02>;
		ranges;
		linux,phandle = <0x4d>;
		phandle = <0x4d>;

		zmc-default {
			compatible = "mediatek,zone_movable_cma";
			size = <0x00 0xffc00000>;
			alignment = <0x00 0x10000000>;
			alloc-ranges = <0x00 0xc0000000 0x01 0x80000000>;
		};

		reserve-memory-sspm_share {
			compatible = "mediatek,reserve-memory-sspm_share";
			no-map;
			status = "okay";
			size = <0x00 0x510000>;
			alignment = <0x00 0x10000>;
			alloc-ranges = <0x00 0x40000000 0x00 0x60000000>;
		};

		reserve-memory-scp_share {
			compatible = "mediatek,reserve-memory-scp_share";
			no-map;
			size = <0x00 0x300000>;
			alignment = <0x00 0x1000000>;
			alloc-ranges = <0x00 0x40000000 0x00 0x50000000>;
		};

		consys-reserve-memory {
			compatible = "mediatek,consys-reserve-memory";
			no-map;
			size = <0x00 0x400000>;
			alignment = <0x00 0x1000000>;
			alloc-ranges = <0x00 0x40000000 0x00 0x80000000>;
		};

		wifi-reserve-memory {
			compatible = "mediatek,wifi-reserve-memory";
			no-map;
			size = <0x00 0x300000>;
			alignment = <0x00 0x1000000>;
			alloc-ranges = <0x00 0x40000000 0x00 0x80000000>;
		};

		soter-shared-mem {
			compatible = "microtrust,shared_mem";
			no-map;
			size = <0x00 0x600000>;
			alloc-ranges = <0x00 0x40000000 0x00 0x50000000>;
		};
	};

	cpu_dbgapb@0d410000 {
		compatible = "mediatek,hw_dbg";
		num = <0x08>;
		reg = <0x00 0xd410000 0x00 0x1000 0x00 0xd510000 0x00 0x1000 0x00 0xd610000 0x00 0x1000 0x00 0xd710000 0x00 0x1000 0x00 0xd810000 0x00 0x1000 0x00 0xd910000 0x00 0x1000 0x00 0xda10000 0x00 0x1000 0x00 0xdb10000 0x00 0x1000>;
		linux,phandle = <0x4e>;
		phandle = <0x4e>;
	};

	atf_logger {
		compatible = "mediatek,atf_logger";
		interrupts = <0x00 0xf7 0x01>;
	};

	amms_control {
		compatible = "mediatek,amms";
		interrupts = <0x00 0x86 0x01>;
	};

	utos {
		compatible = "microtrust,utos";
		interrupts = <0x00 0xf9 0x01 0x00 0xfa 0x01>;
	};

	utos_tester {
		compatible = "microtrust,tester-v1";
	};

	tkcore {
		compatible = "trustkernel,tkcore";
		interrupts = <0x00 0xf8 0x01>;
	};

	plat_sram_flag@0011db00 {
		compatible = "mediatek,plat_sram_flag";
		reg = <0x00 0x10e5f0 0x00 0x10>;
	};

	interrupt-controller@0c000000 {
		compatible = "arm,gic-v3";
		#interrupt-cells = <0x03>;
		#address-cells = <0x02>;
		#size-cells = <0x02>;
		#redistributor-regions = <0x01>;
		interrupt-parent = <0x11>;
		interrupt-controller;
		reg = <0x00 0xc000000 0x00 0x40000 0x00 0xc100000 0x00 0x200000 0x00 0x10200a80 0x00 0x50>;
		interrupts = <0x01 0x09 0x04>;
		linux,phandle = <0x11>;
		phandle = <0x11>;
	};

	intpol-controller@10200a80 {
		compatible = "mediatek,mt6577-sysirq";
		interrupt-controller;
		#interrupt-cells = <0x03>;
		interrupt-parent = <0x11>;
		reg = <0x00 0x10200a80 0x00 0x50>;
		linux,phandle = <0x01>;
		phandle = <0x01>;
	};

	infracfg_ao@10001000 {
		compatible = "mediatek,infracfg_ao\0syscon";
		reg = <0x00 0x10001000 0x00 0x1000>;
		interrupts = <0x00 0x93 0x01>;
		#clock-cells = <0x01>;
		linux,phandle = <0x25>;
		phandle = <0x25>;
	};

	mcdi@0010fc00 {
		compatible = "mediatek,mt6765-mcdi";
		reg = <0x00 0x10fc00 0x00 0x800>;
	};

	scpsys@10001000 {
		compatible = "mediatek,scpsys\0syscon";
		reg = <0x00 0x10001000 0x00 0x1000 0x00 0x10006000 0x00 0x1000 0x00 0x14002000 0x00 0x1000 0x00 0x1020e000 0x00 0x1000 0x00 0x18004000 0x00 0x1000 0x00 0x18002000 0x00 0x1000>;
		#clock-cells = <0x01>;
		linux,phandle = <0x26>;
		phandle = <0x26>;
	};

	topckgen@10000000 {
		compatible = "mediatek,topckgen\0syscon";
		reg = <0x00 0x10000000 0x00 0x1000>;
		#clock-cells = <0x01>;
		linux,phandle = <0x1e>;
		phandle = <0x1e>;
	};

	io_cfg_lt@10002000 {
		compatible = "mediatek,io_cfg_lt";
		reg = <0x00 0x10002000 0x00 0x200>;
	};

	syscfg_pctl_1@0x10002000 {
		compatible = "mediatek,mt6765-pctl-1-syscfg\0syscon";
		reg = <0x00 0x10002000 0x00 0x1000>;
		linux,phandle = <0x13>;
		phandle = <0x13>;
	};

	io_cfg_lm@10002200 {
		compatible = "mediatek,io_cfg_lm";
		reg = <0x00 0x10002200 0x00 0x200>;
	};

	syscfg_pctl_2@0x10002200 {
		compatible = "mediatek,mt6765-pctl-2-syscfg\0syscon";
		reg = <0x00 0x10002200 0x00 0x1000>;
		linux,phandle = <0x14>;
		phandle = <0x14>;
	};

	io_cfg_lb@10002400 {
		compatible = "mediatek,io_cfg_lb";
		reg = <0x00 0x10002400 0x00 0x200>;
	};

	syscfg_pctl_3@0x10002400 {
		compatible = "mediatek,mt6765-pctl-3-syscfg\0syscon";
		reg = <0x00 0x10002400 0x00 0x1000>;
		linux,phandle = <0x15>;
		phandle = <0x15>;
	};

	io_cfg_bl@10002600 {
		compatible = "mediatek,io_cfg_bl";
		reg = <0x00 0x10002600 0x00 0x200>;
	};

	syscfg_pctl_4@0x10002600 {
		compatible = "mediatek,mt6765-pctl-4-syscfg\0syscon";
		reg = <0x00 0x10002600 0x00 0x1000>;
		linux,phandle = <0x16>;
		phandle = <0x16>;
	};

	io_cfg_rr@10002800 {
		compatible = "mediatek,io_cfg_rr";
		reg = <0x00 0x10002800 0x00 0x200>;
	};

	syscfg_pctl_5@0x10002800 {
		compatible = "mediatek,mt6765-pctl-5-syscfg\0syscon";
		reg = <0x00 0x10002800 0x00 0x1000>;
		linux,phandle = <0x17>;
		phandle = <0x17>;
	};

	io_cfg_rb@10002a00 {
		compatible = "mediatek,io_cfg_rb";
		reg = <0x00 0x10002a00 0x00 0x200>;
	};

	syscfg_pctl_6@0x10002a00 {
		compatible = "mediatek,mt6765-pctl-6-syscfg\0syscon";
		reg = <0x00 0x10002a00 0x00 0x1000>;
		linux,phandle = <0x18>;
		phandle = <0x18>;
	};

	io_cfg_rt@10002c00 {
		compatible = "mediatek,io_cfg_rt";
		reg = <0x00 0x10002c00 0x00 0x200>;
	};

	syscfg_pctl_7@0x10002c00 {
		compatible = "mediatek,mt6765-pctl-7-syscfg\0syscon";
		reg = <0x00 0x10002c00 0x00 0x1000>;
		linux,phandle = <0x19>;
		phandle = <0x19>;
	};

	pericfg@10003000 {
		compatible = "mediatek,pericfg\0syscon";
		reg = <0x00 0x10003000 0x00 0x1000>;
		#clock-cells = <0x01>;
		linux,phandle = <0x4f>;
		phandle = <0x4f>;
	};

	efuse_dbg@10004000 {
		compatible = "mediatek,efuse_dbg";
		reg = <0x00 0x10004000 0x00 0x1000>;
	};

	gpio {
		compatible = "mediatek,gpio_usage_mapping";
		linux,phandle = <0x50>;
		phandle = <0x50>;
	};

	gpio@10005000 {
		compatible = "mediatek,gpio";
		reg = <0x00 0x10005000 0x00 0x1000>;
		linux,phandle = <0x51>;
		phandle = <0x51>;
	};

	syscfg_pctl_0@10005000 {
		compatible = "mediatek,mt6765-pctl-0-syscfg\0syscon";
		reg = <0x00 0x10005000 0x00 0x1000>;
		linux,phandle = <0x12>;
		phandle = <0x12>;
	};

	pinctrl@1000b000 {
		compatible = "mediatek,mt6765-pinctrl";
		reg = <0x00 0x1000b000 0x00 0x1000>;
		mediatek,pctl-regmap = <0x12 0x13 0x14 0x15 0x16 0x17 0x18 0x19>;
		pins-are-numbered;
		gpio-controller;
		#gpio-cells = <0x02>;
		interrupt-controller;
		#interrupt-cells = <0x04>;
		interrupts = <0x00 0xab 0x04>;
		linux,phandle = <0x20>;
		phandle = <0x20>;

		msdc0@default {
			linux,phandle = <0x33>;
			phandle = <0x33>;

			pins_cmd {
				drive-strength = [03];
			};

			pins_dat {
				drive-strength = [03];
			};

			pins_clk {
				drive-strength = [03];
			};

			pins_rst {
				drive-strength = [03];
			};

			pins_ds {
				drive-strength = [03];
			};
		};

		msdc0@hs400 {
			linux,phandle = <0x34>;
			phandle = <0x34>;

			pins_cmd {
				drive-strength = [03];
			};

			pins_dat {
				drive-strength = [04];
			};

			pins_clk {
				drive-strength = [04];
			};

			pins_rst {
				drive-strength = [03];
			};

			pins_ds {
				drive-strength = [04];
			};
		};

		msdc0@hs200 {
			linux,phandle = <0x35>;
			phandle = <0x35>;

			pins_cmd {
				drive-strength = [03];
			};

			pins_dat {
				drive-strength = [04];
			};

			pins_clk {
				drive-strength = [04];
			};

			pins_rst {
				drive-strength = [03];
			};

			pins_ds {
				drive-strength = [04];
			};
		};

		msdc0@register_default {
			cmd_edge = [00];
			rdata_edge = [00];
			wdata_edge = [00];
			linux,phandle = <0x36>;
			phandle = <0x36>;
		};

		msdc1@default {
			linux,phandle = <0x38>;
			phandle = <0x38>;

			pins_cmd {
				drive-strength = [04];
			};

			pins_dat {
				drive-strength = [04];
			};

			pins_clk {
				drive-strength = [07];
			};
		};

		msdc1@sdr104 {
			linux,phandle = <0x39>;
			phandle = <0x39>;

			pins_cmd {
				drive-strength = [04];
			};

			pins_dat {
				drive-strength = [04];
			};

			pins_clk {
				drive-strength = [07];
			};
		};

		msdc1@sdr50 {
			linux,phandle = <0x3a>;
			phandle = <0x3a>;

			pins_cmd {
				drive-strength = [04];
			};

			pins_dat {
				drive-strength = [04];
			};

			pins_clk {
				drive-strength = [07];
			};
		};

		msdc1@ddr50 {
			linux,phandle = <0x3b>;
			phandle = <0x3b>;

			pins_cmd {
				drive-strength = [04];
			};

			pins_dat {
				drive-strength = [04];
			};

			pins_clk {
				drive-strength = [07];
			};
		};

		msdc1@register_default {
			cmd_edge = [00];
			rdata_edge = [00];
			wdata_edge = [00];
			linux,phandle = <0x3c>;
			phandle = <0x3c>;
		};

		msdc3@default {
			linux,phandle = <0x52>;
			phandle = <0x52>;

			pins_cmd {
				drive-strength = [04];
			};

			pins_dat {
				drive-strength = [04];
			};

			pins_clk {
				drive-strength = [04];
			};
		};

		msdc3@register_default {
			cmd_edge = [01];
			rdata_edge = [01];
			wdata_edge = [01];
			linux,phandle = <0x53>;
			phandle = <0x53>;
		};
	};

	sleep@10006000 {
		compatible = "mediatek,sleep";
		reg = <0x00 0x10006000 0x00 0x1000>;
		interrupts = <0x00 0xb5 0x08>;
		wakeup-source = <0x1a 0x00 0x04 0x1b 0x01 0x20 0x1c 0x03 0x2000000>;
	};

	toprgu@10007000 {
		compatible = "mediatek,mt6765-toprgu";
		reg = <0x00 0x10007000 0x00 0x1000>;
		interrupts = <0x00 0x8b 0x00>;
	};

	chipid@08000000 {
		compatible = "mediatek,chipid";
		reg = <0x00 0x8000000 0x00 0x04 0x00 0x8000004 0x00 0x04 0x00 0x8000008 0x00 0x04 0x00 0x800000c 0x00 0x04>;
	};

	mobicore {
		compatible = "trustonic,mobicore";
		interrupts = <0x00 0x10f 0x01>;
	};

	timer {
		compatible = "arm,armv8-timer";
		interrupt-parent = <0x11>;
		interrupts = <0x01 0x0d 0x08 0x01 0x0e 0x08 0x01 0x0b 0x08 0x01 0x0a 0x08>;
		clock-frequency = <0xc65d40>;
	};

	clocks {

		clk26m {
			compatible = "fixed-clock";
			#clock-cells = <0x00>;
			clock-frequency = <0x18cba80>;
			linux,phandle = <0x1f>;
			phandle = <0x1f>;
		};

		clk32k {
			compatible = "fixed-clock";
			#clock-cells = <0x00>;
			clock-frequency = <0x7d00>;
			linux,phandle = <0x1d>;
			phandle = <0x1d>;
		};
	};

	apxgpt@10008000 {
		compatible = "mediatek,apxgpt";
		reg = <0x00 0x10008000 0x00 0x1000>;
		interrupts = <0x00 0xaa 0x08>;
		clocks = <0x1d>;
	};

	hacc@1000a000 {
		compatible = "mediatek,hacc";
		reg = <0x00 0x1000a000 0x00 0x1000>;
		interrupts = <0x00 0xbd 0x08>;
	};

	apmixed@1000c000 {
		compatible = "mediatek,apmixed\0syscon";
		reg = <0x00 0x1000c000 0x00 0x1000>;
		#clock-cells = <0x01>;
		linux,phandle = <0x41>;
		phandle = <0x41>;
	};

	fhctl@1000ce00 {
		compatible = "mediatek,fhctl";
		reg = <0x00 0x1000ce00 0x00 0x200>;
	};

	pwrap@1000d000 {
		compatible = "mediatek,pwrap";
		reg = <0x00 0x1000d000 0x00 0x1000>;
		interrupts = <0x00 0xb3 0x04>;
	};

	mt-pmic {
		compatible = "mediatek,mt_pmic";
		interrupt-controller;
		linux,phandle = <0x54>;
		phandle = <0x54>;

		mt635x-auxadc {
			compatible = "mediatek,mt635x-auxadc";
			#io-channel-cells = <0x01>;
			linux,phandle = <0x55>;
			phandle = <0x55>;

			batadc {
				channel = <0x00>;
				resistance-ratio = <0x03 0x01>;
				avg-num = <0x80>;
			};

			isense {
				channel = <0x01>;
				resistance-ratio = <0x03 0x01>;
				avg-num = <0x80>;
			};

			vcdt {
				channel = <0x02>;
			};

			bat_temp {
				channel = <0x03>;
				resistance-ratio = <0x01 0x01>;
			};

			chip_temp {
				channel = <0x05>;
			};

			vcore_temp {
				channel = <0x06>;
			};

			vproc_temp {
				channel = <0x07>;
			};

			accdet {
				channel = <0x09>;
			};

			tsx_temp {
				channel = <0x0b>;
				avg-num = <0x80>;
			};

			hpofs_cal {
				channel = <0x0c>;
				avg-num = <0x100>;
			};

			dcxo_temp {
				channel = <0x0d>;
				avg-num = <0x10>;
			};

			vbif {
				channel = <0x0e>;
				resistance-ratio = <0x01 0x01>;
			};
		};

		buck_regulators {

			buck_vs1 {
				regulator-name = "vs1";
				regulator-min-microvolt = <0x124f80>;
				regulator-max-microvolt = <0x2191c0>;
				regulator-ramp-delay = <0x30d4>;
				regulator-enable-ramp-delay = <0xdc>;
				linux,phandle = <0x56>;
				phandle = <0x56>;
			};

			buck_vmodem {
				regulator-name = "vmodem";
				regulator-min-microvolt = <0x7a120>;
				regulator-max-microvolt = <0x123716>;
				regulator-ramp-delay = <0x186a>;
				regulator-enable-ramp-delay = <0xdc>;
				linux,phandle = <0x57>;
				phandle = <0x57>;
			};

			buck_vcore {
				regulator-name = "vcore";
				regulator-min-microvolt = <0x7ea5e>;
				regulator-max-microvolt = <0x1406f4>;
				regulator-ramp-delay = <0x186a>;
				regulator-enable-ramp-delay = <0xdc>;
				linux,phandle = <0x58>;
				phandle = <0x58>;
			};

			buck_vproc {
				regulator-name = "vproc";
				regulator-min-microvolt = <0x7ea5e>;
				regulator-max-microvolt = <0x1406f4>;
				regulator-ramp-delay = <0x186a>;
				regulator-enable-ramp-delay = <0xdc>;
				linux,phandle = <0x59>;
				phandle = <0x59>;
			};

			buck_vpa {
				regulator-name = "vpa";
				regulator-min-microvolt = <0x7a120>;
				regulator-max-microvolt = <0x37b1d0>;
				regulator-ramp-delay = <0xc350>;
				regulator-enable-ramp-delay = <0xdc>;
				linux,phandle = <0x5a>;
				phandle = <0x5a>;
			};
		};

		ldo_regulators {

			ldo_vfe28 {
				compatible = "regulator-fixed";
				regulator-name = "vfe28";
				regulator-min-microvolt = <0x2ab980>;
				regulator-max-microvolt = <0x2ab980>;
				regulator-enable-ramp-delay = <0x108>;
				linux,phandle = <0x5b>;
				phandle = <0x5b>;
			};

			ldo_vxo22 {
				regulator-name = "vxo22";
				regulator-min-microvolt = <0x2191c0>;
				regulator-max-microvolt = <0x249f00>;
				regulator-enable-ramp-delay = <0x6e>;
				linux,phandle = <0x5c>;
				phandle = <0x5c>;
			};

			ldo_vrf18 {
				compatible = "regulator-fixed";
				regulator-name = "vrf18";
				regulator-min-microvolt = <0x1b7740>;
				regulator-max-microvolt = <0x1b7740>;
				regulator-enable-ramp-delay = <0x6e>;
				linux,phandle = <0x5d>;
				phandle = <0x5d>;
			};

			ldo_vrf12 {
				compatible = "regulator-fixed";
				regulator-name = "vrf12";
				regulator-min-microvolt = <0x124f80>;
				regulator-max-microvolt = <0x124f80>;
				regulator-enable-ramp-delay = <0x6e>;
				linux,phandle = <0x5e>;
				phandle = <0x5e>;
			};

			ldo_vefuse {
				regulator-name = "vefuse";
				regulator-min-microvolt = <0x124f80>;
				regulator-max-microvolt = <0x325aa0>;
				regulator-enable-ramp-delay = <0x108>;
				linux,phandle = <0x5f>;
				phandle = <0x5f>;
			};

			ldo_vcn33_bt {
				regulator-name = "vcn33_bt";
				regulator-min-microvolt = <0x325aa0>;
				regulator-max-microvolt = <0x3567e0>;
				regulator-enable-ramp-delay = <0x108>;
				linux,phandle = <0x60>;
				phandle = <0x60>;
			};

			ldo_vcn33_wifi {
				regulator-name = "vcn33_wifi";
				regulator-min-microvolt = <0x325aa0>;
				regulator-max-microvolt = <0x3567e0>;
				regulator-enable-ramp-delay = <0x108>;
				linux,phandle = <0x61>;
				phandle = <0x61>;
			};

			ldo_vcn28 {
				compatible = "regulator-fixed";
				regulator-name = "vcn28";
				regulator-min-microvolt = <0x2ab980>;
				regulator-max-microvolt = <0x2ab980>;
				regulator-enable-ramp-delay = <0x108>;
				linux,phandle = <0x62>;
				phandle = <0x62>;
			};

			ldo_vcn18 {
				compatible = "regulator-fixed";
				regulator-name = "vcn18";
				regulator-min-microvolt = <0x1b7740>;
				regulator-max-microvolt = <0x1b7740>;
				regulator-enable-ramp-delay = <0x108>;
				linux,phandle = <0x63>;
				phandle = <0x63>;
			};

			ldo_vcama {
				regulator-name = "vcama";
				regulator-min-microvolt = <0x2625a0>;
				regulator-max-microvolt = <0x2ab980>;
				regulator-enable-ramp-delay = <0x108>;
				linux,phandle = <0x64>;
				phandle = <0x64>;
			};

			ldo_vcamd {
				regulator-name = "vcamd";
				regulator-min-microvolt = <0xf4240>;
				regulator-max-microvolt = <0x1b7740>;
				regulator-enable-ramp-delay = <0x108>;
				linux,phandle = <0x65>;
				phandle = <0x65>;
			};

			ldo_vcamio {
				compatible = "regulator-fixed";
				regulator-name = "vcamio";
				regulator-min-microvolt = <0x1b7740>;
				regulator-max-microvolt = <0x1b7740>;
				regulator-enable-ramp-delay = <0x108>;
				linux,phandle = <0x66>;
				phandle = <0x66>;
			};

			ldo_vldo28 {
				regulator-name = "vldo28";
				regulator-min-microvolt = <0x2ab980>;
				regulator-max-microvolt = <0x2dc6c0>;
				regulator-enable-ramp-delay = <0x108>;
				linux,phandle = <0x67>;
				phandle = <0x67>;
			};

			ldo_vsram_others {
				regulator-name = "vsram_others";
				regulator-min-microvolt = <0x7ea5e>;
				regulator-max-microvolt = <0x1406f4>;
				regulator-ramp-delay = <0x186a>;
				regulator-enable-ramp-delay = <0x6e>;
				linux,phandle = <0x68>;
				phandle = <0x68>;
			};

			ldo_vsram_proc {
				regulator-name = "vsram_proc";
				regulator-min-microvolt = <0x7ea5e>;
				regulator-max-microvolt = <0x1406f4>;
				regulator-ramp-delay = <0x186a>;
				regulator-enable-ramp-delay = <0x6e>;
				linux,phandle = <0x69>;
				phandle = <0x69>;
			};

			ldo_vaux18 {
				compatible = "regulator-fixed";
				regulator-name = "vaux18";
				regulator-min-microvolt = <0x1b7740>;
				regulator-max-microvolt = <0x1b7740>;
				regulator-enable-ramp-delay = <0x108>;
				linux,phandle = <0x6a>;
				phandle = <0x6a>;
			};

			ldo_vaud28 {
				compatible = "regulator-fixed";
				regulator-name = "vaud28";
				regulator-min-microvolt = <0x2ab980>;
				regulator-max-microvolt = <0x2ab980>;
				regulator-enable-ramp-delay = <0x108>;
				linux,phandle = <0x6b>;
				phandle = <0x6b>;
			};

			ldo_vio28 {
				compatible = "regulator-fixed";
				regulator-name = "vio28";
				regulator-min-microvolt = <0x2ab980>;
				regulator-max-microvolt = <0x2ab980>;
				regulator-enable-ramp-delay = <0x108>;
				linux,phandle = <0x6c>;
				phandle = <0x6c>;
			};

			ldo_vio18 {
				compatible = "regulator-fixed";
				regulator-name = "vio18";
				regulator-min-microvolt = <0x1b7740>;
				regulator-max-microvolt = <0x1b7740>;
				regulator-enable-ramp-delay = <0x108>;
				linux,phandle = <0x6d>;
				phandle = <0x6d>;
			};

			ldo_vdram {
				regulator-name = "vdram";
				regulator-min-microvolt = <0x10c8e0>;
				regulator-max-microvolt = <0x124f80>;
				regulator-enable-ramp-delay = <0xce4>;
				linux,phandle = <0x6e>;
				phandle = <0x6e>;
			};

			ldo_vmc {
				regulator-name = "vmc";
				regulator-min-microvolt = <0x1b7740>;
				regulator-max-microvolt = <0x325aa0>;
				regulator-enable-ramp-delay = <0x2c>;
				linux,phandle = <0x3e>;
				phandle = <0x3e>;
			};

			ldo_vmch {
				regulator-name = "vmch";
				regulator-min-microvolt = <0x2c4020>;
				regulator-max-microvolt = <0x325aa0>;
				regulator-enable-ramp-delay = <0x2c>;
				linux,phandle = <0x3d>;
				phandle = <0x3d>;
			};

			ldo_vemc {
				regulator-name = "vemc";
				regulator-min-microvolt = <0x2c4020>;
				regulator-max-microvolt = <0x325aa0>;
				regulator-enable-ramp-delay = <0x2c>;
				linux,phandle = <0x37>;
				phandle = <0x37>;
			};

			ldo_vsim1 {
				regulator-name = "vsim1";
				regulator-min-microvolt = <0x19f0a0>;
				regulator-max-microvolt = <0x2f4d60>;
				regulator-enable-ramp-delay = <0x108>;
				linux,phandle = <0x6f>;
				phandle = <0x6f>;
			};

			ldo_vsim2 {
				regulator-name = "vsim2";
				regulator-min-microvolt = <0x19f0a0>;
				regulator-max-microvolt = <0x2f4d60>;
				regulator-enable-ramp-delay = <0x108>;
				linux,phandle = <0x70>;
				phandle = <0x70>;
			};

			ldo_vibr {
				regulator-name = "vibr";
				regulator-min-microvolt = <0x124f80>;
				regulator-max-microvolt = <0x325aa0>;
				regulator-enable-ramp-delay = <0x2c>;
				linux,phandle = <0x71>;
				phandle = <0x71>;
			};

			ldo_vusb33 {
				regulator-name = "vusb33";
				regulator-min-microvolt = <0x2dc6c0>;
				regulator-max-microvolt = <0x2f4d60>;
				regulator-enable-ramp-delay = <0x108>;
				linux,phandle = <0x72>;
				phandle = <0x72>;
			};
		};
	};

	scp@10500000 {
		compatible = "mediatek,scp";
		status = "okay";
		reg = <0x00 0x10500000 0x00 0x40000 0x00 0x105c0000 0x00 0x3000 0x00 0x105c4000 0x00 0x1000 0x00 0x105d4000 0x00 0x6000>;
		interrupts = <0x00 0xc0 0x04>;
		core_1 = "enable";
		scp_sramSize = <0x40000>;
	};

	scp_dvfs {
		compatible = "mediatek,scp_dvfs";
		clocks = <0x1e 0x63 0x1f 0x1e 0x0e 0x1e 0x1a 0x1e 0x02 0x1e 0x17 0x1e 0x06 0x1e 0x19>;
		clock-names = "clk_mux\0clk_pll_0\0clk_pll_1\0clk_pll_2\0clk_pll_3\0clk_pll_4\0clk_pll_5\0clk_pll_6";
	};

	sleep_reg_md@1000f000 {
		compatible = "mediatek,sleep_reg_md";
		reg = <0x00 0x1000f000 0x00 0x1000>;
	};

	kp@10010000 {
		compatible = "mediatek,kp";
		reg = <0x00 0x10010000 0x00 0x1000>;
		interrupts = <0x00 0xb4 0x02>;
		linux,phandle = <0x1a>;
		phandle = <0x1a>;
	};

	otg_iddig {
		compatible = "mediatek,usb_iddig_bi_eint";
		linux,phandle = <0x73>;
		phandle = <0x73>;
	};

	mrdump_ext_rst {
		compatible = "mediatek, mrdump_ext_rst-eint";
		force_mode = "EINT";
		mode = "IRQ";
		status = "okay";
		linux,phandle = <0x74>;
		phandle = <0x74>;
	};

	touch {
		compatible = "mediatek,touch";
		linux,phandle = <0x75>;
		phandle = <0x75>;
	};

	accdet {
		compatible = "mediatek,pmic-accdet";
		linux,phandle = <0x76>;
		phandle = <0x76>;
	};

	fingerprint {
		compatible = "mediatek,goodix-fp";
		linux,phandle = <0x77>;
		phandle = <0x77>;
	};

	fpsensor_fp_eint {
		compatible = "mediatek,fpsensor_fp_eint";
		int-gpios = <0x20 0x02 0x00>;
		linux,phandle = <0x78>;
		phandle = <0x78>;
	};

	fpsensor_finger {
		compatible = "mediatek,fingerprint";
		fpc,enable-wakeup;
		linux,phandle = <0x79>;
		phandle = <0x79>;
	};

	chr_stat {
		compatible = "mediatek, chr_stat-eint";
		linux,phandle = <0x7a>;
		phandle = <0x7a>;
	};

	ant_check {
		compatible = "longcheer,ant_check";
		ant_check_gpio = <0x20 0x4e 0x00>;
	};

	ant_check_div {
		compatible = "longcheer,ant_check_div";
		ant_check_div_gpio = <0x20 0x36 0x00>;
	};

	simtray {
		compatible = "xiaomi,simtray-status";
		status-gpio = <0x20 0x01 0x00>;
	};

	swtp {
		compatible = "mediatek, swtp-eint";
		linux,phandle = <0x7b>;
		phandle = <0x7b>;
	};

	swtp1 {
		compatible = "mediatek, swtp1-eint";
		linux,phandle = <0x7c>;
		phandle = <0x7c>;
	};

	mt6357_gauge {
		compatible = "mediatek,mt6357_gauge";
		gauge_name = "gauge";
		alias_name = "mt6357";
	};

	gauge_timer {
		compatible = "mediatek,gauge_timer_service";
	};

	battery {
		compatible = "mediatek,bat_gm30";
		DIFFERENCE_FULLOCV_ITH = <0x122>;
		SHUTDOWN_1_TIME = <0x1e>;
		KEEP_100_PERCENT = <0x01>;
		R_FG_VALUE = <0x0a>;
		EMBEDDED_SEL = <0x01>;
		PMIC_SHUTDOWN_CURRENT = <0x14>;
		FG_METER_RESISTANCE = <0x4b>;
		CAR_TUNE_VALUE = <0x64>;
		PMIC_MIN_VOL = <0x82dc>;
		POWERON_SYSTEM_IBOOT = <0x1f4>;
		SHUTDOWN_GAUGE0_VOLTAGE = <0x84d0>;
		TEMPERATURE_T0 = <0x32>;
		TEMPERATURE_T1 = <0x19>;
		TEMPERATURE_T2 = <0x0a>;
		TEMPERATURE_T3 = <0x00>;
		TEMPERATURE_T4 = <0xfffffff6>;
		g_FG_PSEUDO100_T0 = <0x63>;
		g_FG_PSEUDO100_T1 = <0x63>;
		g_FG_PSEUDO100_T2 = <0x5f>;
		g_FG_PSEUDO100_T3 = <0x5f>;
		g_FG_PSEUDO100_T4 = <0x5f>;
		Q_MAX_SYS_VOLTAGE_BAT0 = <0xd48>;
		Q_MAX_SYS_VOLTAGE_BAT1 = <0xd48>;
		Q_MAX_SYS_VOLTAGE_BAT2 = <0xd16>;
		Q_MAX_SYS_VOLTAGE_BAT3 = <0xd16>;
		battery0_profile_t0_num = <0x64>;
		battery0_profile_t0 = <0x00 0xaaa0 0x30c 0x1f7 0xaa22 0x308 0x3ee 0xa9ab 0x307 0x5e6 0xa93b 0x314 0x7dd 0xa8ca 0x320 0x9d4 0xa857 0x325 0xbcb 0xa7e9 0x338 0xdc3 0xa774 0x323 0xfba 0xa6ff 0x320 0x11b1 0xa689 0x320 0x13a8 0xa614 0x320 0x15a0 0xa59e 0x320 0x1797 0xa529 0x320 0x198e 0xa4b4 0x320 0x1b85 0xa43e 0x320 0x1d7c 0xa3ce 0x32f 0x1f74 0xa35d 0x32f 0x216b 0xa2ea 0x326 0x2362 0xa27c 0x337 0x2559 0xa205 0x321 0x2751 0xa197 0x334 0x2948 0xa12a 0x329 0x2b3f 0xa0bd 0x32c 0x2d36 0xa053 0x339 0x2f2e 0x9fed 0x339 0x3125 0x9f80 0x339 0x331c 0x9f1b 0x339 0x3513 0x9ebd 0x34a 0x370b 0x9e5c 0x352 0x3902 0x9dfb 0x352 0x3af9 0x9d9e 0x352 0x3cf0 0x9d42 0x352 0x3ee7 0x9ce6 0x352 0x40df 0x9c8a 0x352 0x42d6 0x9c33 0x35f 0x44cd 0x9bdf 0x36b 0x46c4 0x9b8d 0x376 0x48bc 0x9b41 0x39d 0x4ab3 0x9aed 0x39d 0x4caa 0x9a99 0x3c1 0x4ea1 0x9a40 0x3dd 0x5099 0x99c7 0x3b5 0x5290 0x9933 0x35f 0x5487 0x98a8 0x337 0x567e 0x9844 0x322 0x5875 0x97f6 0x320 0x5a6d 0x97b0 0x320 0x5c64 0x9771 0x320 0x5e5b 0x9734 0x320 0x6052 0x96f3 0x320 0x624a 0x96c1 0x320 0x6441 0x9687 0x30c 0x6638 0x9652 0x307 0x682f 0x9625 0x313 0x6a27 0x95f7 0x320 0x6c1e 0x95c6 0x320 0x6e15 0x959c 0x320 0x700c 0x9572 0x335 0x7203 0x9548 0x328 0x73fb 0x951e 0x320 0x75f2 0x94f8 0x320 0x77e9 0x94d6 0x325 0x79e0 0x94b5 0x339 0x7bd8 0x9493 0x339 0x7dcf 0x9479 0x34b 0x7fc6 0x945a 0x352 0x81bd 0x9438 0x352 0x83b5 0x9417 0x358 0x85ac 0x93f3 0x369 0x87a3 0x93b9 0x354 0x899a 0x9360 0x31a 0x8b91 0x9315 0x316 0x8d89 0x92df 0x32b 0x8f80 0x92b2 0x339 0x9177 0x9280 0x339 0x936e 0x924e 0x339 0x9566 0x9223 0x339 0x975d 0x91f9 0x339 0x9954 0x91cf 0x339 0x9b4b 0x91a5 0x339 0x9d43 0x917a 0x33c 0x9f3a 0x9148 0x351 0xa131 0x9105 0x33e 0xa328 0x90c9 0x349 0xa520 0x9089 0x346 0xa717 0x9040 0x331 0xa90e 0x8ff5 0x320 0xab05 0x8fd4 0x320 0xacfc 0x8fcc 0x335 0xaef4 0x8fbc 0x339 0xb0eb 0x8fab 0x361 0xb2e2 0x8f93 0x3a0 0xb4d9 0x8f50 0x3ba 0xb6d1 0x8e99 0x36b 0xb8c8 0x8cfe 0x36b 0xbabf 0x8ad1 0x38f 0xbcb6 0x87df 0x3d6 0xbeae 0x835c 0x4c2 0xc0a5 0x7bba 0x10ee 0xc29c 0x71a2 0xb09>;
		battery0_profile_t1_num = <0x64>;
		battery0_profile_t1 = <0x00 0xaab4 0x3e8 0x1f7 0xaa47 0x3e8 0x3ee 0xa9da 0x3f9 0x5e6 0xa968 0x3f4 0x7dd 0xa8f6 0x3f1 0x9d4 0xa887 0x3fc 0xbcb 0xa812 0x3e9 0xdc3 0xa7a5 0x3fe 0xfba 0xa731 0x401 0x11b1 0xa6bb 0x401 0x13a8 0xa646 0x401 0x15a0 0xa5d0 0x3fb 0x1797 0xa55b 0x3e8 0x198e 0xa4e6 0x3e8 0x1b85 0xa470 0x3e8 0x1d7c 0xa400 0x3f7 0x1f74 0xa38f 0x401 0x216b 0xa31c 0x407 0x2362 0xa2ae 0x41a 0x2559 0xa237 0x41a 0x2751 0xa1c9 0x41a 0x2948 0xa15c 0x41a 0x2b3f 0xa0ef 0x41a 0x2d36 0xa085 0x422 0x2f2e 0xa01f 0x42f 0x3125 0x9fb2 0x41a 0x331c 0x9f4d 0x42f 0x3513 0x9ee9 0x433 0x370b 0x9e89 0x440 0x3902 0x9e29 0x44c 0x3af9 0x9dc6 0x44c 0x3cf0 0x9d6a 0x44c 0x3ee7 0x9d0e 0x461 0x40df 0x9cb9 0x476 0x42d6 0x9c65 0x48b 0x44cd 0x9c11 0x4aa 0x46c4 0x9bbd 0x4ce 0x48bc 0x9b69 0x4e3 0x4ab3 0x9b15 0x4f8 0x4caa 0x9ac1 0x50d 0x4ea1 0x9a5c 0x506 0x5099 0x99e3 0x4dd 0x5290 0x9958 0x48c 0x5487 0x98c5 0x418 0x567e 0x9858 0x403 0x5875 0x980a 0x401 0x5a6d 0x97be 0x3f2 0x5c64 0x9777 0x3e8 0x5e5b 0x9737 0x3e8 0x6052 0x96fc 0x3e5 0x624a 0x96c1 0x3d0 0x6441 0x968f 0x3cf 0x6638 0x965c 0x3cf 0x682f 0x962a 0x3cf 0x6a27 0x95fa 0x3cf 0x6c1e 0x95d0 0x3d3 0x6e15 0x95a6 0x3e8 0x700c 0x957c 0x3e8 0x7203 0x9552 0x3e8 0x73fb 0x952d 0x3e8 0x75f2 0x950c 0x3f1 0x77e9 0x94ea 0x401 0x79e0 0x94c9 0x401 0x7bd8 0x94a7 0x401 0x7dcf 0x948d 0x413 0x7fc6 0x946e 0x41a 0x81bd 0x9450 0x41a 0x83b5 0x9435 0x41a 0x85ac 0x9413 0x41a 0x87a3 0x93f2 0x41a 0x899a 0x93c9 0x3f5 0x8b91 0x939f 0x3e8 0x8d89 0x9371 0x3dd 0x8f80 0x9341 0x3cf 0x9177 0x9316 0x3cd 0x936e 0x92e4 0x3b8 0x9566 0x92b9 0x3c9 0x975d 0x928f 0x3c0 0x9954 0x926a 0x3b6 0x9b4b 0x9248 0x3c5 0x9d43 0x9223 0x3e5 0x9f3a 0x91e8 0x3d0 0xa131 0x91ad 0x3cf 0xa328 0x9173 0x3cf 0xa520 0x9138 0x3cf 0xa717 0x90f4 0x3c7 0xa90e 0x90a3 0x3b2 0xab05 0x9060 0x39d 0xacfc 0x904f 0x3b2 0xaef4 0x9045 0x3c7 0xb0eb 0x9037 0x3cf 0xb2e2 0x9023 0x3e2 0xb4d9 0x9001 0x411 0xb6d1 0x8fb8 0x447 0xb8c8 0x8e8a 0x3f3 0xbabf 0x8cad 0x40c 0xbcb6 0x8a28 0x445 0xbeae 0x8684 0x4ca 0xc0a5 0x8031 0xd1e 0xc29c 0x74cc 0x12c0>;
		battery0_profile_t2_num = <0x64>;
		battery0_profile_t2 = <0x00 0xaac8 0x672 0x1f7 0xaa4a 0x672 0x3ee 0xa9d3 0x672 0x5e6 0xa963 0x67f 0x7dd 0xa8f2 0x682 0x9d4 0xa87d 0x672 0xbcb 0xa807 0x672 0xdc3 0xa792 0x672 0xfba 0xa71d 0x672 0x11b1 0xa6a7 0x672 0x13a8 0xa632 0x672 0x15a0 0xa5bc 0x672 0x1797 0xa547 0x672 0x198e 0xa4d2 0x672 0x1b85 0xa45c 0x672 0x1d7c 0xa3ec 0x681 0x1f74 0xa37b 0x68b 0x216b 0xa306 0x68b 0x2362 0xa291 0x68b 0x2559 0xa222 0x68b 0x2751 0xa1b5 0x69f 0x2948 0xa148 0x6a4 0x2b3f 0xa0db 0x6a4 0x2d36 0xa06e 0x6ac 0x2f2e 0xa002 0x6c1 0x3125 0x9f9e 0x6d6 0x331c 0x9f39 0x6d6 0x3513 0x9ed5 0x6e7 0x370b 0x9e75 0x6fc 0x3902 0x9e15 0x710 0x3af9 0x9db1 0x721 0x3cf0 0x9d4c 0x722 0x3ee7 0x9cf8 0x74c 0x40df 0x9c9e 0x753 0x42d6 0x9c41 0x753 0x44cd 0x9be9 0x766 0x46c4 0x9b95 0x78a 0x48bc 0x9b41 0x79e 0x4ab3 0x9ae4 0x79e 0x4caa 0x9a81 0x78c 0x4ea1 0x9a11 0x769 0x5099 0x9993 0x720 0x5290 0x9910 0x6be 0x5487 0x9894 0x66e 0x567e 0x9830 0x644 0x5875 0x97da 0x62d 0x5a6d 0x9792 0x627 0x5c64 0x974f 0x61c 0x5e5b 0x970c 0x607 0x6052 0x96cb 0x5f8 0x624a 0x9699 0x60d 0x6441 0x965f 0x5fa 0x6638 0x962a 0x605 0x682f 0x95f8 0x602 0x6a27 0x95c8 0x5fd 0x6c1e 0x959e 0x60e 0x6e15 0x9574 0x60e 0x700c 0x954a 0x60e 0x7203 0x9520 0x60e 0x73fb 0x94fb 0x61b 0x75f2 0x94da 0x627 0x77e9 0x94b8 0x62c 0x79e0 0x9497 0x640 0x7bd8 0x9475 0x640 0x7dcf 0x9454 0x640 0x7fc6 0x9437 0x640 0x81bd 0x941a 0x640 0x83b5 0x93fb 0x640 0x85ac 0x93e2 0x642 0x87a3 0x93c9 0x657 0x899a 0x93b0 0x646 0x8b91 0x9397 0x640 0x8d89 0x9379 0x635 0x8f80 0x9357 0x627 0x9177 0x9334 0x624 0x936e 0x930a 0x60f 0x9566 0x92d8 0x60e 0x975d 0x92b3 0x61e 0x9954 0x928c 0x627 0x9b4b 0x9263 0x62f 0x9d43 0x9236 0x644 0x9f3a 0x91fb 0x659 0xa131 0x91b8 0x66e 0xa328 0x917c 0x693 0xa520 0x913c 0x6bd 0xa717 0x90ee 0x6df 0xa90e 0x9099 0x6fc 0xab05 0x905f 0x73b 0xacfc 0x9046 0x77a 0xaef4 0x902d 0x7cb 0xb0eb 0x9014 0x81e 0xb2e2 0x8ff7 0x898 0xb4d9 0x8fc7 0x955 0xb6d1 0x8f5c 0xa53 0xb8c8 0x8e0c 0xb78 0xbabf 0x8be9 0xd78 0xbcb6 0x88ed 0x1199 0xbeae 0x843c 0x1cd3 0xc0a5 0x7c7a 0x24db 0xc29c 0x7508 0x1482>;
		battery0_profile_t3_num = <0x64>;
		battery0_profile_t3 = <0x00 0xaad2 0xb22 0x1f7 0xaa43 0xb22 0x3ee 0xa9c9 0xb55 0x5e6 0xa94f 0xb6d 0x7dd 0xa8d8 0xb76 0x9d4 0xa869 0xb86 0xbcb 0xa7f3 0xb86 0xdc3 0xa77e 0xb86 0xfba 0xa709 0xb86 0x11b1 0xa68e 0xb78 0x13a8 0xa614 0xb6d 0x15a0 0xa59e 0xb6d 0x1797 0xa529 0xb6d 0x198e 0xa4b4 0xb6d 0x1b85 0xa43e 0xb5a 0x1d7c 0xa3cd 0xb72 0x1f74 0xa35b 0xb86 0x216b 0xa2e8 0xb86 0x2362 0xa27a 0xb86 0x2559 0xa205 0xb86 0x2751 0xa197 0xb86 0x2948 0xa12a 0xb96 0x2b3f 0xa0bd 0xb9f 0x2d36 0xa050 0xb9f 0x2f2e 0x9fe4 0xba3 0x3125 0x9f80 0xbb8 0x331c 0x9f13 0xbb8 0x3513 0x9ead 0xbc9 0x370b 0x9e48 0xbde 0x3902 0x9de7 0xbfb 0x3af9 0x9d89 0xc18 0x3cf0 0x9d24 0xc03 0x3ee7 0x9cbf 0xc03 0x40df 0x9c62 0xc03 0x42d6 0x9c05 0xc10 0x44cd 0x9ba9 0xc1c 0x46c4 0x9b4b 0xc17 0x48bc 0x9ae6 0xc01 0x4ab3 0x9a79 0xbd7 0x4caa 0x9a0c 0xbad 0x4ea1 0x9999 0xb66 0x5099 0x9923 0xb1d 0x5290 0x98b3 0xae4 0x5487 0x984f 0xabc 0x567e 0x97f3 0xaa7 0x5875 0x979e 0xa92 0x5a6d 0x9750 0xa7d 0x5c64 0x9709 0xa73 0x5e5b 0x96c9 0xa73 0x6052 0x968e 0xa73 0x624a 0x9653 0xa73 0x6441 0x9621 0xa87 0x6638 0x95ee 0xa8c 0x682f 0x95bb 0xa98 0x6a27 0x9589 0xaa5 0x6c1e 0x9558 0xaa5 0x6e15 0x952e 0xaa5 0x700c 0x9504 0xaba 0x7203 0x94e1 0xacf 0x73fb 0x94ba 0xad7 0x75f2 0x9494 0xae0 0x77e9 0x9472 0xaf0 0x79e0 0x9451 0xaf1 0x7bd8 0x942f 0xb06 0x7dcf 0x9415 0xb1b 0x7fc6 0x93fb 0xb22 0x81bd 0x93e6 0xb35 0x83b5 0x93d5 0xb5a 0x85ac 0x93c5 0xb6f 0x87a3 0x93b4 0xb84 0x899a 0x93a3 0xbab 0x8b91 0x9392 0xbd5 0x8d89 0x9382 0xc14 0x8f80 0x936c 0xc61 0x9177 0x9349 0xca3 0x936e 0x931f 0xcf7 0x9566 0x92ed 0xd5e 0x975d 0x92bb 0xdf5 0x9954 0x9289 0xebf 0x9b4b 0x9256 0xfb6 0x9d43 0x9220 0x10ce 0x9f3a 0x91dd 0x11f3 0xa131 0x9192 0x1319 0xa328 0x914d 0x143e 0xa520 0x910a 0x157d 0xa717 0x90bc 0x16cc 0xa90e 0x9066 0x1829 0xab05 0x9023 0x19ba 0xacfc 0x8ff9 0x1b9c 0xaef4 0x8fd6 0x1e1b 0xb0eb 0x8fb5 0x2175 0xb2e2 0x8f8f 0x261a 0xb4d9 0x8f54 0x2cb4 0xb6d1 0x8edb 0x35e3 0xb8c8 0x8d9c 0x3f3a 0xbabf 0x8ba0 0x4b2c 0xbcb6 0x88b0 0x44b7 0xbeae 0x8444 0x3987 0xc0a5 0x805c 0x3ae3 0xc29c 0x788c 0x3ae3>;
		battery0_profile_t4_num = <0x64>;
		battery0_profile_t4 = <0x00 0xaae6 0x1aae 0x1f7 0xaa36 0x1aaa 0x3ee 0xa99a 0x1b20 0x5e6 0xa908 0x1b65 0x7dd 0xa87d 0x1b83 0x9d4 0xa7f7 0x1ba3 0xbcb 0xa771 0x1ba2 0xdc3 0xa6f3 0x1b8d 0xfba 0xa676 0x1b8a 0x11b1 0xa5f8 0x1b7c 0x13a8 0xa57a 0x1b67 0x15a0 0xa4fe 0x1b58 0x1797 0xa488 0x1b55 0x198e 0xa40a 0x1b2b 0x1b85 0xa394 0x1b13 0x1d7c 0xa324 0x1b0d 0x1f74 0xa2af 0x1af8 0x216b 0xa236 0x1adb 0x2362 0xa1c8 0x1ad9 0x2559 0xa151 0x1ac3 0x2751 0xa0e3 0x1ac2 0x2948 0xa076 0x1ac2 0x2b3f 0xa009 0x1ab6 0x2d36 0x9f9f 0x1ab1 0x2f2e 0x9f39 0x1ac2 0x3125 0x9ecc 0x1ac2 0x331c 0x9e57 0x1aad 0x3513 0x9de8 0x1a98 0x370b 0x9d7b 0x1a90 0x3902 0x9d0e 0x1a7f 0x3af9 0x9ca3 0x1a5a 0x3cf0 0x9c3e 0x1a45 0x3ee7 0x9bd9 0x1a30 0x40df 0x9b75 0x1a09 0x42d6 0x9b0b 0x19df 0x44cd 0x9aa1 0x19bf 0x46c4 0x9a3b 0x19a4 0x48bc 0x99ce 0x197c 0x4ab3 0x9969 0x1967 0x4caa 0x9905 0x1964 0x4ea1 0x98a5 0x1939 0x5099 0x9848 0x1919 0x5290 0x97ee 0x1913 0x5487 0x979a 0x18fe 0x567e 0x9746 0x18e9 0x5875 0x96fa 0x18e7 0x5a6d 0x96af 0x18d8 0x5c64 0x966c 0x18e5 0x5e5b 0x9632 0x1900 0x6052 0x95f7 0x1903 0x624a 0x95bc 0x1918 0x6441 0x958a 0x192d 0x6638 0x9557 0x1942 0x682f 0x952a 0x1963 0x6a27 0x9500 0x1985 0x6c1e 0x94d6 0x199a 0x6e15 0x94ac 0x19af 0x700c 0x948a 0x19c4 0x7203 0x9470 0x19ea 0x73fb 0x9456 0x1a14 0x75f2 0x9441 0x1a47 0x77e9 0x9430 0x1a8c 0x79e0 0x941f 0x1ae0 0x7bd8 0x940e 0x1b34 0x7dcf 0x93fd 0x1b9a 0x7fc6 0x93ed 0x1c2d 0x81bd 0x93dc 0x1cdf 0x83b5 0x93c9 0x1dae 0x85ac 0x93b0 0x1eaa 0x87a3 0x93a0 0x1fa6 0x899a 0x9387 0x2126 0x8b91 0x9368 0x22f1 0x8d89 0x9346 0x250a 0x8f80 0x9325 0x2785 0x9177 0x9303 0x2a60 0x936e 0x92e2 0x2d29 0x9566 0x92b8 0x3019 0x975d 0x928e 0x325f 0x9954 0x9260 0x346b 0x9b4b 0x922d 0x362a 0x9d43 0x91f8 0x3756 0x9f3a 0x91b5 0x383c 0xa131 0x917a 0x394c 0xa328 0x9139 0x39b7 0xa520 0x90f6 0x3a8c 0xa717 0x90af 0x3b9e 0xa90e 0x9062 0x3c95 0xab05 0x9019 0x3dfe 0xacfc 0x8ff7 0x3fe1 0xaef4 0x8fd5 0x4287 0xb0eb 0x8fb9 0x469b 0xb2e2 0x8f98 0x4ddf 0xb4d9 0x8f6c 0x5536 0xb6d1 0x8f0c 0x5481 0xb8c8 0x8ddc 0x51dc 0xbabf 0x8c32 0x4da3 0xbcb6 0x8462 0x4da3 0xbeae 0x78aa 0x4da3 0xc0a5 0x74c2 0x4da3 0xc29c 0x70da 0x4da3>;
		battery1_profile_t0_num = <0x64>;
		battery1_profile_t0 = <0x00 0xaa14 0x30c 0x1f9 0xa98d 0x308 0x3f1 0xa90e 0x318 0x5ea 0xa890 0x320 0x7e2 0xa811 0x320 0x9db 0xa793 0x320 0xbd3 0xa716 0x321 0xdcc 0xa6a0 0x336 0xfc4 0xa623 0x327 0x11bd 0xa5aa 0x32e 0x13b5 0xa535 0x339 0x15ae 0xa4bd 0x333 0x17a7 0xa440 0x322 0x199f 0xa3d3 0x337 0x1b98 0xa360 0x339 0x1d90 0xa2ea 0x339 0x1f89 0xa275 0x339 0x2181 0xa202 0x339 0x237a 0xa194 0x33c 0x2572 0xa127 0x351 0x276b 0xa0ba 0x352 0x2963 0xa046 0x342 0x2b5c 0x9fda 0x345 0x2d55 0x9f72 0x352 0x2f4d 0x9f06 0x352 0x3146 0x9ea1 0x352 0x333e 0x9e3c 0x352 0x3537 0x9dd7 0x352 0x372f 0x9d78 0x35f 0x3928 0x9d18 0x362 0x3b20 0x9cb5 0x352 0x3d19 0x9c59 0x355 0x3f11 0x9c05 0x37f 0x410a 0x9ba9 0x372 0x4303 0x9b53 0x379 0x44fb 0x9afe 0x384 0x46f4 0x9aaa 0x38a 0x48ec 0x9a57 0x3a2 0x4ae5 0x9a0c 0x3cc 0x4cdd 0x99b0 0x3e2 0x4ed6 0x9947 0x3d9 0x50ce 0x98c4 0x3a2 0x52c7 0x983a 0x364 0x54bf 0x97c8 0x34f 0x56b8 0x976c 0x33a 0x58b1 0x9727 0x339 0x5aa9 0x96e4 0x339 0x5ca2 0x96a6 0x339 0x5e9a 0x966b 0x339 0x6093 0x9630 0x335 0x628b 0x95f5 0x320 0x6484 0x95c3 0x320 0x667c 0x9590 0x320 0x6875 0x9563 0x32d 0x6a6d 0x9539 0x339 0x6c66 0x950f 0x339 0x6e5f 0x94e5 0x339 0x7057 0x94bb 0x339 0x7250 0x9491 0x339 0x7448 0x946d 0x348 0x7641 0x944b 0x352 0x7839 0x942a 0x352 0x7a32 0x9409 0x355 0x7c2a 0x93f0 0x36a 0x7e23 0x93d6 0x37f 0x801b 0x93b7 0x384 0x8214 0x939a 0x390 0x840d 0x937b 0x39d 0x8605 0x9349 0x38e 0x87fe 0x92f7 0x33c 0x89f6 0x92b3 0x339 0x8bef 0x9283 0x349 0x8de7 0x9259 0x352 0x8fe0 0x922f 0x352 0x91d8 0x9203 0x34e 0x93d1 0x91d1 0x339 0x95c9 0x91b0 0x339 0x97c2 0x918e 0x34b 0x99bb 0x9167 0x352 0x9bb3 0x9139 0x352 0x9dac 0x9104 0x352 0x9fa4 0x90c9 0x352 0xa19d 0x9086 0x352 0xa395 0x9042 0x352 0xa58e 0x8ff3 0x343 0xa786 0x8fb9 0x339 0xa97f 0x8f9d 0x339 0xab77 0x8f8d 0x33e 0xad70 0x8f85 0x369 0xaf69 0x8f7c 0x3a6 0xb161 0x8f67 0x3e5 0xb35a 0x8f1f 0x3f5 0xb552 0x8e56 0x3d0 0xb74b 0x8cd5 0x3a1 0xb943 0x8ac3 0x3b6 0xbb3c 0x87e0 0x3f5 0xbd34 0x8397 0x486 0xbf2d 0x7b0b 0x1127 0xc125 0x71de 0xb6d 0xc31e 0x71de 0xb6d>;
		battery1_profile_t1_num = <0x64>;
		battery1_profile_t1 = <0x00 0xaa78 0x438 0x1f9 0xa9fa 0x434 0x3f1 0xa983 0x433 0x5ea 0xa908 0x440 0x7e2 0xa88d 0x44c 0x9db 0xa815 0x44c 0xbd3 0xa798 0x44c 0xdcc 0xa722 0x44c 0xfc4 0xa6ac 0x45e 0x11bd 0xa631 0x449 0x13b5 0xa5b7 0x43d 0x15ae 0xa541 0x44c 0x17a7 0xa4cb 0x44c 0x199f 0xa456 0x44c 0x1b98 0xa3e9 0x439 0x1d90 0xa376 0x433 0x1f89 0xa305 0x43e 0x2181 0xa298 0x44c 0x237a 0xa229 0x44c 0x2572 0xa1b4 0x44c 0x276b 0xa146 0x44c 0x2963 0xa0d8 0x45c 0x2b5c 0xa06b 0x465 0x2d55 0x9ffe 0x465 0x2f4d 0x9f94 0x469 0x3146 0x9f38 0x47f 0x333e 0x9efd 0x4d3 0x3537 0x9eb4 0x4e2 0x372f 0x9e43 0x4d5 0x3928 0x9da7 0x4b7 0x3b20 0x9cf6 0x492 0x3d19 0x9c61 0x47f 0x3f11 0x9bf4 0x494 0x410a 0x9bb3 0x4ce 0x4303 0x9b7e 0x4e2 0x44fb 0x9b4b 0x4ec 0x46f4 0x9b11 0x501 0x48ec 0x9ac5 0x514 0x4ae5 0x9a7a 0x514 0x4cdd 0x9a1e 0x527 0x4ed6 0x99bc 0x51e 0x50ce 0x994f 0x509 0x52c7 0x98d4 0x4d0 0x54bf 0x9850 0x45c 0x56b8 0x97db 0x41d 0x58b1 0x9785 0x41a 0x5aa9 0x9738 0x40a 0x5ca2 0x96f1 0x40d 0x5e9a 0x96b1 0x409 0x6093 0x9676 0x3ec 0x628b 0x963b 0x401 0x6484 0x9609 0x401 0x667c 0x95d6 0x401 0x6875 0x95a4 0x401 0x6a6d 0x9575 0x401 0x6c66 0x954b 0x401 0x6e5f 0x9521 0x401 0x7057 0x94f7 0x401 0x7250 0x94d4 0x413 0x7448 0x94b3 0x41a 0x7641 0x9491 0x425 0x7839 0x9470 0x433 0x7a32 0x944e 0x433 0x7c2a 0x942c 0x433 0x7e23 0x9412 0x447 0x801b 0x93f9 0x45c 0x8214 0x93db 0x459 0x840d 0x93bd 0x454 0x8605 0x93a2 0x461 0x87fe 0x9381 0x44d 0x89f6 0x935f 0x438 0x8bef 0x933e 0x423 0x8de7 0x931c 0x40e 0x8fe0 0x92fb 0x401 0x91d8 0x92d7 0x401 0x93d1 0x92ad 0x401 0x95c9 0x928c 0x401 0x97c2 0x9263 0x401 0x99bb 0x923e 0x401 0x9bb3 0x9219 0x401 0x9dac 0x91ef 0x407 0x9fa4 0x91c2 0x418 0xa19d 0x9177 0x403 0xa395 0x913a 0x414 0xa58e 0x90ff 0x429 0xa786 0x90b3 0x428 0xa97f 0x9064 0x421 0xab77 0x9036 0x433 0xad70 0x9025 0x433 0xaf69 0x901c 0x46e 0xb161 0x9007 0x47e 0xb35a 0x8ff3 0x4a1 0xb552 0x8fd2 0x4e1 0xb74b 0x8f6f 0x508 0xb943 0x8e59 0x4c9 0xbb3c 0x8c7b 0x508 0xbd34 0x89f5 0x557 0xbf2d 0x8659 0x5e9 0xc125 0x7f79 0xe15 0xc31e 0x73a0 0xfa0>;
		battery1_profile_t2_num = <0x64>;
		battery1_profile_t2 = <0x00 0xaa8c 0x834 0x1f9 0xaa16 0x834 0x3f1 0xa993 0x856 0x5ea 0xa90c 0x866 0x7e2 0xa889 0x866 0x9db 0xa80b 0x861 0xbd3 0xa78e 0x84d 0xdcc 0xa718 0x84d 0xfc4 0xa6a2 0x83b 0x11bd 0xa627 0x826 0x13b5 0xa5ad 0x81b 0x15ae 0xa537 0x81b 0x17a7 0xa4c2 0x81b 0x199f 0xa455 0x81b 0x1b98 0xa3e2 0x808 0x1d90 0xa372 0x802 0x1f89 0xa305 0x80d 0x2181 0xa298 0x81b 0x237a 0xa22a 0x81b 0x2572 0xa1bd 0x81b 0x276b 0xa148 0x81b 0x2963 0xa0df 0x82b 0x2b5c 0xa075 0x834 0x2d55 0xa00b 0x82c 0x2f4d 0x9fad 0x827 0x3146 0x9f6a 0x867 0x333e 0x9f2f 0x8d0 0x3537 0x9ed1 0x8f4 0x372f 0x9e48 0x8e2 0x3928 0x9d99 0x8a5 0x3b20 0x9ce0 0x85b 0x3d19 0x9c43 0x834 0x3f11 0x9bcd 0x834 0x410a 0x9b75 0x846 0x4303 0x9b2c 0x85b 0x44fb 0x9aed 0x87b 0x46f4 0x9ab5 0x8ab 0x48ec 0x9a7f 0x8e1 0x4ae5 0x9a34 0x8cc 0x4cdd 0x99d8 0x8a3 0x4ed6 0x996f 0x86a 0x50ce 0x98ff 0x820 0x52c7 0x988d 0x7d4 0x54bf 0x9821 0x795 0x56b8 0x97bc 0x756 0x58b1 0x9767 0x73f 0x5aa9 0x971a 0x73a 0x5ca2 0x96d8 0x73a 0x5e9a 0x969d 0x742 0x6093 0x9660 0x74a 0x628b 0x961d 0x721 0x6484 0x95eb 0x736 0x667c 0x95bf 0x73a 0x6875 0x9590 0x73a 0x6a6d 0x9561 0x743 0x6c66 0x9537 0x753 0x6e5f 0x950d 0x754 0x7057 0x94e3 0x769 0x7250 0x94c0 0x76c 0x7448 0x949f 0x77b 0x7641 0x947d 0x785 0x7839 0x945c 0x785 0x7a32 0x943b 0x788 0x7c2a 0x9422 0x79d 0x7e23 0x9401 0x79e 0x801b 0x93e5 0x79e 0x8214 0x93cc 0x79e 0x840d 0x93b6 0x79e 0x8605 0x93a5 0x7a2 0x87fe 0x9395 0x7b6 0x89f6 0x9384 0x7b7 0x8bef 0x9379 0x7c7 0x8de7 0x936c 0x7dc 0x8fe0 0x9355 0x7e9 0x91d8 0x9333 0x7e9 0x93d1 0x9311 0x7e9 0x95c9 0x92e7 0x7e9 0x97c2 0x92bd 0x7fb 0x99bb 0x9298 0x81d 0x9bb3 0x926f 0x83e 0x9dac 0x923a 0x858 0x9fa4 0x91ff 0x882 0xa19d 0x91bc 0x8ac 0xa395 0x9180 0x8e9 0xa58e 0x9139 0x919 0xa786 0x90e9 0x94e 0xa97f 0x909d 0x994 0xab77 0x9067 0x9ed 0xad70 0x904e 0xa6c 0xaf69 0x9034 0xad6 0xb161 0x901b 0xb6e 0xb35a 0x8ffd 0xc46 0xb552 0x8fc6 0xd5a 0xb74b 0x8f4d 0xe99 0xb943 0x8e59 0xfe9 0xbb3c 0x8c62 0x10fb 0xbd34 0x89bc 0x1356 0xbf2d 0x85dc 0x1759 0xc125 0x7f29 0x1ee2 0xc31e 0x7422 0x11ad>;
		battery1_profile_t3_num = <0x64>;
		battery1_profile_t3 = <0x00 0xaac8 0x1022 0x1f9 0xaa20 0x101e 0x3f1 0xa985 0x1050 0x5ea 0xa8ee 0x104e 0x7e2 0xa85e 0x1036 0x9db 0xa7d7 0x1031 0xbd3 0xa751 0x101c 0xdcc 0xa6d3 0x1007 0xfc4 0xa65c 0x1004 0x11bd 0xa5e1 0xfe8 0x13b5 0xa567 0xfd2 0x15ae 0xa4f1 0xfc6 0x17a7 0xa47b 0xf9b 0x199f 0xa406 0xf71 0x1b98 0xa399 0xf6e 0x1d90 0xa32c 0xf5f 0x1f89 0xa2bf 0xf4a 0x2181 0xa252 0xf20 0x237a 0xa1e4 0xecf 0x2572 0xa177 0xe90 0x276b 0xa10a 0xe51 0x2963 0xa09c 0xe22 0x2b5c 0xa039 0xe10 0x2d55 0x9fe3 0xe28 0x2f4d 0x9f99 0xe70 0x3146 0x9f55 0xed8 0x333e 0x9ef9 0xf18 0x3537 0x9e6c 0xede 0x372f 0x9dc0 0xe70 0x3928 0x9d0e 0xe04 0x3b20 0x9c6c 0xdb5 0x3d19 0x9be0 0xd7a 0x3f11 0x9b7b 0xd7a 0x410a 0x9b25 0xd7a 0x4303 0x9adc 0xd88 0x44fb 0x9a99 0xd9d 0x46f4 0x9a56 0xdb2 0x48ec 0x9a10 0xdc0 0x4ae5 0x99bc 0xd96 0x4cdd 0x9960 0xd59 0x4ed6 0x98fe 0xd1a 0x50ce 0x989a 0xcd0 0x52c7 0x9836 0xc7d 0x54bf 0x97d2 0xc2f 0x56b8 0x9776 0xc05 0x58b1 0x9729 0xbdb 0x5aa9 0x96de 0xbc1 0x5ca2 0x969c 0xbb8 0x5e9a 0x9661 0xbb0 0x6093 0x9626 0xb9f 0x628b 0x95eb 0xb9f 0x6484 0x95c1 0xbb4 0x667c 0x9590 0xbb8 0x6875 0x955e 0xbb8 0x6a6d 0x952f 0xbb8 0x6c66 0x9507 0xbbd 0x6e5f 0x94e5 0xbd2 0x7057 0x94bb 0xbe7 0x7250 0x9498 0xbfc 0x7448 0x9477 0xc12 0x7641 0x9455 0xc1c 0x7839 0x9436 0xc29 0x7a32 0x941c 0xc4b 0x7c2a 0x93fa 0xc36 0x7e23 0x93e8 0xc49 0x801b 0x93d7 0xc6d 0x8214 0x93cb 0xc97 0x840d 0x93c0 0xcba 0x8605 0x93b1 0xcd2 0x87fe 0x93a8 0xcfc 0x89f6 0x9398 0xd26 0x8bef 0x9387 0xd60 0x8de7 0x9376 0xd9f 0x8fe0 0x9362 0xdde 0x91d8 0x9347 0xe1d 0x93d1 0x9325 0xe5c 0x95c9 0x9304 0xe9b 0x97c2 0x92db 0xeec 0x99bb 0x92ac 0xf4e 0x9bb3 0x9279 0xfb7 0x9dac 0x9244 0x1031 0x9fa4 0x9209 0x10d9 0xa19d 0x91c6 0x1181 0xa395 0x917b 0x123c 0xa58e 0x912f 0x1308 0xa786 0x90e4 0x13e5 0xa97f 0x909d 0x14d9 0xab77 0x9065 0x15ed 0xad70 0x903b 0x1714 0xaf69 0x9018 0x1889 0xb161 0x8ff7 0x1a52 0xb35a 0x8fc7 0x1c7d 0xb552 0x8f76 0x1f0d 0xb74b 0x8ee6 0x21fd 0xb943 0x8de1 0x2531 0xbb3c 0x8c03 0x2936 0xbd34 0x8970 0x2f00 0xbf2d 0x85b3 0x357d 0xc125 0x7f92 0x2da3 0xc31e 0x762a 0x165d>;
		battery1_profile_t4_num = <0x64>;
		battery1_profile_t4 = <0x00 0xaae6 0x235a 0x1f9 0xaa1c 0x235a 0x3f1 0xa959 0x23af 0x5ea 0xa8a7 0x23d7 0x7e2 0xa807 0x23aa 0x9db 0xa76f 0x233b 0xbd3 0xa6d9 0x22bf 0xdcc 0xa652 0x226b 0xfc4 0xa5c4 0x223c 0x11bd 0xa541 0x21d9 0x13b5 0xa4c3 0x2179 0x15ae 0xa445 0x2121 0x17a7 0xa3c7 0x2097 0x199f 0xa352 0x2058 0x1b98 0xa2de 0x201a 0x1d90 0xa268 0x1fea 0x1f89 0xa1f7 0x1f9f 0x2181 0xa187 0x1f3d 0x237a 0xa114 0x1ee6 0x2572 0xa0af 0x1e7d 0x276b 0xa05a 0x1e50 0x2963 0xa006 0x1e36 0x2b5c 0x9fad 0x1e21 0x2d55 0x9f43 0x1dfc 0x2f4d 0x9ebf 0x1db8 0x3146 0x9e1f 0x1d64 0x333e 0x9d6e 0x1ca6 0x3537 0x9cd2 0x1c62 0x372f 0x9c45 0x1c38 0x3928 0x9bca 0x1c20 0x3b20 0x9b61 0x1c25 0x3d19 0x9b05 0x1c39 0x3f11 0x9ab1 0x1c39 0x410a 0x9a64 0x1c4b 0x4303 0x9a13 0x1c52 0x44fb 0x99c3 0x1c5c 0x46f4 0x9972 0x1c5e 0x48ec 0x9915 0x1c34 0x4ae5 0x98b9 0x1c0a 0x4cdd 0x985c 0x1bf4 0x4ed6 0x9806 0x1bdf 0x50ce 0x97b3 0x1bbe 0x52c7 0x9762 0x1b9c 0x54bf 0x9717 0x1b87 0x56b8 0x96cb 0x1b72 0x58b1 0x9687 0x1b71 0x5aa9 0x9644 0x1b61 0x5ca2 0x960b 0x1b7d 0x5e9a 0x95d5 0x1b8a 0x6093 0x959c 0x1b61 0x628b 0x9569 0x1b8b 0x6484 0x953f 0x1bca 0x667c 0x9515 0x1bc4 0x6875 0x94eb 0x1bd7 0x6a6d 0x94c5 0x1bf7 0x6c66 0x94a3 0x1c0c 0x6e5f 0x9482 0x1c23 0x7057 0x9469 0x1c4d 0x7250 0x9457 0x1c89 0x7448 0x9446 0x1cba 0x7641 0x9436 0x1cf9 0x7839 0x9425 0x1d4d 0x7a32 0x9414 0x1da1 0x7c2a 0x9403 0x1df5 0x7e23 0x93fa 0x1e5d 0x801b 0x93eb 0x1ed6 0x8214 0x93db 0x1f54 0x840d 0x93ca 0x1fca 0x8605 0x93b9 0x203e 0x87fe 0x93a9 0x20e4 0x89f6 0x9398 0x218c 0x8bef 0x9380 0x2234 0x8de7 0x9367 0x22e8 0x8fe0 0x934e 0x23bf 0x91d8 0x9333 0x24b7 0x93d1 0x9311 0x259e 0x95c9 0x92f0 0x269b 0x97c2 0x92c0 0x2786 0x99bb 0x9293 0x2895 0x9bb3 0x9261 0x29c5 0x9dac 0x9229 0x2b06 0x9fa4 0x91f5 0x2c56 0xa19d 0x91b2 0x2da7 0xa395 0x916e 0x2f0a 0xa58e 0x912b 0x307e 0xa786 0x90e8 0x3203 0xa97f 0x90a7 0x3399 0xab77 0x906d 0x353b 0xad70 0x903b 0x36ca 0xaf69 0x9018 0x3881 0xb161 0x8ff7 0x3a2b 0xb35a 0x8fc7 0x3bb8 0xb552 0x8f80 0x3d42 0xb74b 0x8f0f 0x3eea 0xb943 0x8e45 0x40a4 0xbb3c 0x8c89 0x425d 0xbd34 0x8a0d 0x4520 0xbf2d 0x8699 0x3f18 0xc125 0x80be 0x3092 0xc31e 0x7b98 0x23be>;
		linux,phandle = <0x7d>;
		phandle = <0x7d>;
	};

	topmisc@10011000 {
		compatible = "mediatek,topmisc";
		reg = <0x00 0x10011000 0x00 0x1000>;
	};

	dvfsrc@10012000 {
		compatible = "mediatek,dvfsrc";
		reg = <0x00 0x10012000 0x00 0x1000 0x00 0x110780 0x00 0x80>;
	};

	mbist_ao@10013000 {
		compatible = "mediatek,mbist_ao";
		reg = <0x00 0x10013000 0x00 0x1000>;
	};

	apcldmain_ao@10014000 {
		compatible = "mediatek,apcldmain_ao";
		reg = <0x00 0x10014000 0x00 0x400>;
	};

	apcldmaout_ao@10014400 {
		compatible = "mediatek,apcldmaout_ao";
		reg = <0x00 0x10014400 0x00 0x400>;
	};

	apcldmamisc_ao@10014800 {
		compatible = "mediatek,apcldmamisc_ao";
		reg = <0x00 0x10014800 0x00 0x400>;
	};

	ddrphy@10015000 {
		compatible = "mediatek,ddrphy";
		reg = <0x00 0x10015000 0x00 0x1000>;
	};

	aes_top0@10016000 {
		compatible = "mediatek,aes_top0";
		reg = <0x00 0x10016000 0x00 0x1000>;
	};

	sys_timer@10017000 {
		compatible = "mediatek,sys_timer";
		reg = <0x00 0x10017000 0x00 0x1000>;
		reg-names = "sys_timer_base";
		interrupts = <0x00 0xc2 0x04>;
	};

	modem_temp_share@10018000 {
		compatible = "mediatek,modem_temp_share";
		reg = <0x00 0x10018000 0x00 0x1000>;
	};

	security_ao@1001a000 {
		compatible = "mediatek,security_ao";
		reg = <0x00 0x1001a000 0x00 0x1000>;
	};

	topckgen_ao@1001b000 {
		compatible = "mediatek,topckgen_ao";
		reg = <0x00 0x1001b000 0x00 0x1000>;
	};

	dramc0@1001d000 {
		compatible = "mediatek,dramc0";
		reg = <0x00 0x1001d000 0x00 0x1000>;
	};

	ddrphy@1001e000 {
		compatible = "mediatek,ddrphy";
		reg = <0x00 0x1001e000 0x00 0x1000>;
	};

	iocfg_0@10002000 {
		compatible = "mediatek,iocfg_0";
		reg = <0x00 0x10002000 0x00 0x200>;
	};

	iocfg_1@10002200 {
		compatible = "mediatek,iocfg_1";
		reg = <0x00 0x10002200 0x00 0x200>;
	};

	iocfg_2@10002400 {
		compatible = "mediatek,iocfg_2";
		reg = <0x00 0x10002400 0x00 0x200>;
	};

	iocfg_3@10002600 {
		compatible = "mediatek,iocfg_3";
		reg = <0x00 0x10002600 0x00 0x200>;
	};

	iocfg_4@10002800 {
		compatible = "mediatek,iocfg_4";
		reg = <0x00 0x10002800 0x00 0x200>;
	};

	iocfg_5@10002a00 {
		compatible = "mediatek,iocfg_5";
		reg = <0x00 0x10002a00 0x00 0x200>;
	};

	mdcldmain_ao@10015000 {
		compatible = "mediatek,mdcldmain_ao";
		reg = <0x00 0x10015000 0x00 0x400>;
	};

	mdcldmaout_ao@10015400 {
		compatible = "mediatek,mdcldmaout_ao";
		reg = <0x00 0x10015400 0x00 0x400>;
	};

	mdcldmamisc_ao@10015800 {
		compatible = "mediatek,mdcldmamisc_ao";
		reg = <0x00 0x10015800 0x00 0x400>;
	};

	sys_cirq@10204000 {
		compatible = "mediatek,sys_cirq";
		reg = <0x00 0x10204000 0x00 0x1000>;
		mediatek,cirq_num = <0xd1>;
		mediatek,spi_start_offset = <0x48>;
		interrupts = <0x00 0x118 0x08>;
	};

	mcucfg@10200000 {
		compatible = "mediatek,mcucfg";
		reg = <0x00 0x10200000 0x00 0x1000>;
		interrupts = <0x00 0x00 0x08>;
	};

	mcucfg_mp0_counter@10200000 {
		compatible = "mediatek,mcucfg_mp0_counter";
		reg = <0x00 0x10200000 0x00 0x4000>;
	};

	m4u@10205000 {
		cell-index = <0x00>;
		compatible = "mediatek,iommu_v0";
		reg = <0x00 0x10205000 0x00 0x1000>;
		mediatek,larbs = <0x21 0x22 0x23 0x24>;
		interrupts = <0x00 0x9e 0x08>;
		#iommu-cells = <0x01>;
		linux,phandle = <0x4b>;
		phandle = <0x4b>;
	};

	devapc@10207000 {
		compatible = "mediatek,devapc";
		reg = <0x00 0x10207000 0x00 0x1000 0x00 0x1000e000 0x00 0x1000>;
		interrupts = <0x00 0x8e 0x08>;
		clocks = <0x25 0x28>;
		clock-names = "devapc-infra-clock";
	};

	bus_dbg@10208000 {
		compatible = "mediatek,bus_dbg-v2";
		reg = <0x00 0x10208000 0x00 0x1000 0x00 0x10001000 0x00 0x1000>;
		mediatek,bus_dbg_con_offset = <0x2fc>;
		interrupts = <0x00 0x8d 0x08>;
	};

	ap_ccif0@10209000 {
		compatible = "mediatek,ap_ccif0";
		reg = <0x00 0x10209000 0x00 0x1000>;
		interrupts = <0x00 0x94 0x08>;
	};

	md_ccif0@1020a000 {
		compatible = "mediatek,md_ccif0";
		reg = <0x00 0x1020a000 0x00 0x1000>;
	};

	ap_ccif1@1020b000 {
		compatible = "mediatek,ap_ccif1";
		reg = <0x00 0x1020b000 0x00 0x1000>;
		interrupts = <0x00 0x96 0x08>;
	};

	md_ccif1@1020c000 {
		compatible = "mediatek,md_ccif1";
		reg = <0x00 0x1020c000 0x00 0x1000>;
	};

	infra_mbist@1020d000 {
		compatible = "mediatek,infra_mbist";
		reg = <0x00 0x1020d000 0x00 0x1000>;
	};

	infracfg@1020e000 {
		compatible = "mediatek,infracfg";
		reg = <0x00 0x1020e000 0x00 0x1000>;
	};

	trng@1020f000 {
		compatible = "mediatek,trng";
		reg = <0x00 0x1020f000 0x00 0x1000>;
		interrupts = <0x00 0xa1 0x08>;
	};

	dxcc_sec@10210000 {
		compatible = "mediatek,dxcc_sec";
		reg = <0x00 0x10210000 0x00 0x1000>;
		interrupts = <0x00 0xa2 0x04>;
	};

	mcupm_sram2@10211000 {
		compatible = "mediatek,mcupm_sram2";
		reg = <0x00 0x10211000 0x00 0x1000>;
	};

	cq_dma@10212000 {
		compatible = "mediatek,mt-cqdma-v1";
		reg = <0x00 0x10212000 0x00 0x80 0x00 0x10212080 0x00 0x80>;
		interrupts = <0x00 0x71 0x08 0x00 0x72 0x08>;
		nr_channel = <0x02>;
		keep_clock_ao = "yes";
		clocks = <0x25 0x43>;
		clock-names = "cqdma";
	};

	mcupm_sram3@10213000 {
		compatible = "mediatek,mcupm_sram3";
		reg = <0x00 0x10213000 0x00 0x1000>;
	};

	sramrom@10214000 {
		compatible = "mediatek,sramrom";
		reg = <0x00 0x10214000 0x00 0x1000>;
	};

	mcupm_reg@10216000 {
		compatible = "mediatek,mcupm_reg";
		reg = <0x00 0x10216000 0x00 0x1000>;
	};

	mcupm_sram0@10217000 {
		compatible = "mediatek,mcupm_sram0";
		reg = <0x00 0x10217000 0x00 0x1000>;
	};

	mcupm_sram1@10218000 {
		compatible = "mediatek,mcupm_sram1";
		reg = <0x00 0x10218000 0x00 0x1000>;
	};

	emi@10219000 {
		compatible = "mediatek,emi";
		reg = <0x00 0x10219000 0x00 0x1000 0x00 0x10226000 0x00 0x1000 0x00 0x1022d000 0x00 0x1000 0x00 0x10235000 0x00 0x1000>;
		interrupts = <0x00 0x90 0x08>;
	};

	apcldmain@1021b000 {
		compatible = "mediatek,apcldmain";
		reg = <0x00 0x1021b000 0x00 0x00>;
	};

	apcldmaout@1021b400 {
		compatible = "mediatek,apcldmaout";
		reg = <0x00 0x1021b400 0x00 0x00>;
	};

	apcldmamisc@1021b800 {
		compatible = "mediatek,apcldmamisc";
		reg = <0x00 0x1021b800 0x00 0x00>;
		interrupts = <0x00 0xa5 0x04>;
	};

	mdcldmain@1021c000 {
		compatible = "mediatek,mdcldmain";
		reg = <0x00 0x1021c000 0x00 0x400>;
	};

	mdcldmaout@1021c400 {
		compatible = "mediatek,mdcldmaout";
		reg = <0x00 0x1021c400 0x00 0x400>;
	};

	mdcldmamisc@1021c800 {
		compatible = "mediatek,mdcldmamisc";
		reg = <0x00 0x1021c800 0x00 0x1000>;
	};

	mdcldma@10014000 {
		compatible = "mediatek,mdcldma";
		reg = <0x00 0x10014000 0x00 0x1000 0x00 0x1021b000 0x00 0x1000 0x00 0x10209000 0x00 0x1000 0x00 0x1020a000 0x00 0x1000>;
		interrupts = <0x00 0xa5 0x04 0x00 0x94 0x08 0x00 0x95 0x08 0x00 0x105 0x02>;
		mediatek,md_id = <0x00>;
		mediatek,cldma_capability = <0x06>;
		clocks = <0x26 0x00 0x25 0x32 0x25 0x29 0x25 0x2c 0x25 0x23 0x25 0x24 0x25 0x51 0x25 0x52>;
		clock-names = "scp-sys-md1-main\0infra-cldma-bclk\0infra-ccif-ap\0infra-ccif-md\0infra-ccif1-ap\0infra-ccif1-md\0infra-ccif2-ap\0infra-ccif2-md";
		linux,phandle = <0x1c>;
		phandle = <0x1c>;
	};

	dramc_nao@1021d000 {
		compatible = "mediatek,dramc_nao";
		reg = <0x00 0x1021d000 0x00 0x1000>;
	};

	bpi_bsi_slv0@1021e000 {
		compatible = "mediatek,bpi_bsi_slv0";
		reg = <0x00 0x1021e000 0x00 0x1000>;
	};

	bpi_bsi_slv1@1021f000 {
		compatible = "mediatek,bpi_bsi_slv1";
		reg = <0x00 0x1021f000 0x00 0x6000>;
	};

	bpi_bsi_slv2@10225000 {
		compatible = "mediatek,bpi_bsi_slv2";
		reg = <0x00 0x10225000 0x00 0x1000>;
	};

	dvfsp@10227000 {
		compatible = "mediatek,dvfsp";
		reg = <0x00 0x10227000 0x00 0x1000>;
	};

	dvfsp@00110800 {
		compatible = "mediatek,mt6765-dvfsp";
		reg = <0x00 0x110800 0x00 0x1400 0x00 0x110800 0x00 0x1400>;
	};

	eem_fsm@1100b000 {
		compatible = "mediatek,eem_fsm";
		reg = <0x00 0x1100b000 0x00 0x1000>;
		interrupts = <0x00 0x7d 0x08>;
	};

	dramc@1022a000 {
		compatible = "mediatek,dramc";
		reg = <0x00 0x1022a000 0x00 0x2000 0x00 0x10232000 0x00 0x2000 0x00 0x1022c000 0x00 0x1000 0x00 0x10234000 0x00 0x1000 0x00 0x10228000 0x00 0x2000 0x00 0x10230000 0x00 0x2000 0x00 0x1022e000 0x00 0x1000 0x00 0x10236000 0x00 0x1000>;
	};

	gce@10238000 {
		compatible = "mediatek,gce\0syscon";
		reg = <0x00 0x10238000 0x00 0x4000>;
		#clock-cells = <0x01>;
		interrupts = <0x00 0x9a 0x08 0x00 0x9b 0x08>;
		g3d_config_base = <0x13000000 0x00 0xffff0000>;
		mmsys_config_base = <0x14000000 0x01 0xffff0000>;
		disp_dither_base = <0x14010000 0x02 0xffff0000>;
		mm_na_base = <0x14020000 0x03 0xffff0000>;
		imgsys_base = <0x15020000 0x04 0xffff0000>;
		vdec_gcon_base = <0x18800000 0x05 0xffff0000>;
		venc_gcon_base = <0x18810000 0x06 0xffff0000>;
		conn_peri_base = <0x18820000 0x07 0xffff0000>;
		topckgen_base = <0x18830000 0x08 0xffff0000>;
		kp_base = <0x18840000 0x09 0xffff0000>;
		scp_sram_base = <0x10000000 0x0a 0xffff0000>;
		infra_na3_base = <0x10010000 0x0b 0xffff0000>;
		infra_na4_base = <0x10020000 0x0c 0xffff0000>;
		scp_base = <0x10030000 0x0d 0xffff0000>;
		mcucfg_base = <0x10040000 0x0e 0xffff0000>;
		gcpu_base = <0x10050000 0x0f 0xffff0000>;
		usb0_base = <0x10200000 0x10 0xffff0000>;
		usb_sif_base = <0x10280000 0x11 0xffff0000>;
		audio_base = <0x17000000 0x12 0xffff0000>;
		vdec_base = <0x17010000 0x13 0xffff0000>;
		msdc2_base = <0x17020000 0x14 0xffff0000>;
		vdec1_base = <0x17030000 0x15 0xffff0000>;
		msdc3_base = <0x18000000 0x16 0xffff0000>;
		ap_dma_base = <0x18010000 0x17 0xffff0000>;
		gce_base = <0x18020000 0x18 0xffff0000>;
		vdec2_base = <0x18040000 0x19 0xffff0000>;
		vdec3_base = <0x18050000 0x1a 0xffff0000>;
		camsys_base = <0x18080000 0x1b 0xffff0000>;
		camsys1_base = <0x180a0000 0x1c 0xffff0000>;
		camsys2_base = <0x180b0000 0x1d 0xffff0000>;
		pwm_sw_base = <0x1100e000 0x63 0xffff0000>;
		mipitx0_base = <0x11c80000 0x63 0xffff0000>;
		mdp_rdma0_sof = <0x00>;
		mdp_ccorr0_sof = <0x01>;
		mdp_rsz0_sof = <0x02>;
		mdp_rsz1_sof = <0x03>;
		mdp_wdma_sof = <0x04>;
		mdp_wrot0_sof = <0x05>;
		mdp_tdshp0_sof = <0x06>;
		disp_ovl0_sof = <0x07>;
		disp_2l_ovl0_sof = <0x08>;
		disp_rdma0_sof = <0x09>;
		disp_wdma0_sof = <0x0a>;
		disp_color0_sof = <0x0b>;
		disp_ccorr0_sof = <0x0c>;
		disp_aal0_sof = <0x0d>;
		disp_gamma0_sof = <0x0e>;
		disp_dither0_sof = <0x0f>;
		disp_dsi0_sof = <0x10>;
		disp_rsz0_sof = <0x11>;
		img_dl_relay_sof = <0x12>;
		disp_pwm0_sof = <0x13>;
		mdp_rdma0_frame_done = <0x14>;
		mdp_ccorr0_frame_done = <0x15>;
		mdp_rsz0_frame_done = <0x16>;
		mdp_rsz1_frame_done = <0x17>;
		mdp_wrot0_write_frame_done = <0x18>;
		mdp_wdma_frame_done = <0x19>;
		mdp_tdshp0_frame_done = <0x1a>;
		disp_ovl0_frame_done = <0x1b>;
		disp_2l_ovl0_frame_done = <0x1c>;
		disp_rsz0_frame_done = <0x1d>;
		disp_rdma0_frame_done = <0x1e>;
		disp_wdma0_frame_done = <0x1f>;
		disp_color0_frame_done = <0x20>;
		disp_ccorr0_frame_done = <0x21>;
		disp_aal0_frame_done = <0x22>;
		disp_gamma0_frame_done = <0x23>;
		disp_dither0_frame_done = <0x24>;
		disp_dsi0_frame_done = <0x25>;
		stream_done_0 = <0x82>;
		stream_done_1 = <0x83>;
		stream_done_2 = <0x84>;
		stream_done_3 = <0x85>;
		stream_done_4 = <0x86>;
		stream_done_5 = <0x87>;
		stream_done_6 = <0x88>;
		stream_done_7 = <0x89>;
		stream_done_8 = <0x8a>;
		stream_done_9 = <0x8b>;
		buf_underrun_event_0 = <0x8c>;
		dsi0_te_event = <0x8d>;
		dsi0_irq_event = <0x8e>;
		dsi0_done_event = <0x8f>;
		disp_wdma0_rst_done = <0x93>;
		mdp_wdma_rst_done = <0x94>;
		mdp_wrot0_rst_done = <0x95>;
		mdp_rdma0_rst_done = <0x97>;
		disp_ovl0_frame_rst_done_pusle = <0x98>;
		dip_cq_thread0_frame_done = <0x101>;
		dip_cq_thread1_frame_done = <0x102>;
		dip_cq_thread2_frame_done = <0x103>;
		dip_cq_thread3_frame_done = <0x104>;
		dip_cq_thread4_frame_done = <0x105>;
		dip_cq_thread5_frame_done = <0x106>;
		dip_cq_thread6_frame_done = <0x107>;
		dip_cq_thread7_frame_done = <0x108>;
		dip_cq_thread8_frame_done = <0x109>;
		dip_cq_thread9_frame_done = <0x10a>;
		dip_cq_thread10_frame_done = <0x10b>;
		dip_cq_thread11_frame_done = <0x10c>;
		dip_cq_thread12_frame_done = <0x10d>;
		dip_cq_thread13_frame_done = <0x10e>;
		dip_cq_thread14_frame_done = <0x10f>;
		dip_cq_thread15_frame_done = <0x110>;
		dip_cq_thread16_frame_done = <0x111>;
		dip_cq_thread17_frame_done = <0x112>;
		dip_cq_thread18_frame_done = <0x113>;
		dve_frame_done = <0x114>;
		wmf_frame_done = <0x115>;
		rsc_frame_done = <0x116>;
		venc_done = <0x121>;
		jpgenc_done = <0x122>;
		jpgdec_done = <0x123>;
		venc_mb_done = <0x124>;
		venc_128byte_cnt_done = <0x125>;
		max_prefetch_cnt = <0x01>;
		prefetch_size = <0x60>;
		sram_size_cpr_64 = <0x40>;
		mmsys_config = <0x27>;
		mdp_rdma0 = <0x28>;
		mdp_rsz0 = <0x29>;
		mdp_rsz1 = <0x2a>;
		mdp_wdma0 = <0x2b>;
		mdp_wrot0 = <0x2c>;
		mdp_tdshp0 = <0x2d>;
		mdp_color0 = <0x2e>;
		mdp_ccorr0 = <0x2f>;
		mm_mutex = <0x30>;
		sram_share_cnt = <0x01>;
		sram_share_engine = <0x0a>;
		sram_share_event = <0x2c6>;
		clocks = <0x25 0x09 0x25 0x18>;
		clock-names = "GCE\0GCE_TIMER";
		mediatek,mailbox-gce = <0x31>;
		thread_count = <0x10>;
		secure_thread = <0x08 0x0a>;
		mboxes = <0x31 0x00 0x00 0x04 0x31 0x01 0x00 0x04 0x31 0x02 0x00 0x05 0x31 0x03 0x00 0x04 0x31 0x04 0x00 0x04 0x31 0x05 0x00 0x04 0x31 0x06 0x00 0x03 0x31 0x07 0xffffffff 0x02 0x31 0x08 0x00 0x01 0x31 0x09 0x00 0x01 0x31 0x0a 0x00 0x01 0x31 0x0b 0x00 0x01 0x31 0x0c 0x00 0x01 0x31 0x0d 0x00 0x01 0x31 0x0e 0x00 0x01 0x31 0x0f 0x00 0x01>;
		linux,phandle = <0x7e>;
		phandle = <0x7e>;
	};

	gce_mbox@10238000 {
		compatible = "mediatek,mailbox-gce";
		reg = <0x00 0x10238000 0x00 0x4000>;
		interrupts = <0x00 0x9a 0x08 0x00 0x9b 0x08>;
		#mbox-cells = <0x03>;
		#gce-event-cells = <0x01>;
		#gce-subsys-cells = <0x02>;
		clocks = <0x25 0x09 0x25 0x18>;
		clock-names = "gce\0GCE_TIMER";
		linux,phandle = <0x31>;
		phandle = <0x31>;
	};

	gce_mbox_svp@10238000 {
		compatible = "mediatek,mailbox-gce-svp";
		reg = <0x00 0x10238000 0x00 0x4000>;
		interrupts = <0x00 0x9a 0x08 0x00 0x9b 0x08>;
		#mbox-cells = <0x03>;
		clocks = <0x25 0x09 0x25 0x18>;
		clock-names = "gce\0GCE_TIMER";
		linux,phandle = <0x7f>;
		phandle = <0x7f>;
	};

	ap_ccif2@1023c000 {
		compatible = "mediatek,ap_ccif2";
		reg = <0x00 0x1023c000 0x00 0x1000>;
		interrupts = <0x00 0x8f 0x08>;
	};

	md_ccif2@1023d000 {
		compatible = "mediatek,md_ccif2";
		reg = <0x00 0x1023d000 0x00 0x1000>;
	};

	ap_ccif3@1023e000 {
		compatible = "mediatek,ap_ccif3";
		reg = <0x00 0x1023e000 0x00 0x1000>;
		interrupts = <0x00 0x92 0x08>;
	};

	md_ccif3@1023f000 {
		compatible = "mediatek,md_ccif3";
		reg = <0x00 0x1023f000 0x00 0x1000>;
	};

	sspm@10440000 {
		compatible = "mediatek,sspm";
		reg = <0x00 0x10440000 0x00 0x10000 0x00 0x10450000 0x00 0x100 0x00 0x10451000 0x00 0x08 0x00 0x10460000 0x00 0x100 0x00 0x10461000 0x00 0x08 0x00 0x10470000 0x00 0x100 0x00 0x10471000 0x00 0x08 0x00 0x10480000 0x00 0x100 0x00 0x10481000 0x00 0x08 0x00 0x10490000 0x00 0x100 0x00 0x10491000 0x00 0x08>;
		reg-names = "cfgreg\0mbox0_base\0mbox0_ctrl\0mbox1_base\0mbox1_ctrl\0mbox2_base\0mbox2_ctrl\0mbox3_base\0mbox3_ctrl\0mbox4_base\0mbox4_ctrl";
		interrupts = <0x00 0xca 0x04 0x00 0xcd 0x04 0x00 0xce 0x04 0x00 0xcf 0x04 0x00 0xd0 0x04 0x00 0xd1 0x04>;
		interrupt-names = "ipc\0mbox0\0mbox1\0mbox2\0mbox3\0mbox4";
	};

	gic500@0c000000 {
		compatible = "mediatek,gic500";
		reg = <0x00 0xc000000 0x00 0x1000>;
	};

	gic_cpu@0c400000 {
		compatible = "mediatek,gic_cpu";
		reg = <0x00 0xc400000 0x00 0x40000>;
	};

	dfd@10200b00 {
		compatible = "mediatek,dfd";
		reg = <0x00 0x10200b00 0x00 0x10000>;
		mediatek,enabled = <0x01>;
		mediatek,chain_length = <0xc350>;
		mediatek,rg_dfd_timeout = <0xa0>;
	};

	dbg_cti@0d020000 {
		compatible = "mediatek,dbg_cti";
		reg = <0x00 0xd020000 0x00 0x10000>;
	};

	dbg_etr@0d030000 {
		compatible = "mediatek,dbg_etr";
		reg = <0x00 0xd030000 0x00 0x10000>;
	};

	dbg_funnel@0d040000 {
		compatible = "mediatek,dbg_funnel";
		reg = <0x00 0xd040000 0x00 0x10000>;
	};

	dbg_dem@0d0a0000 {
		compatible = "mediatek,dbg_dem";
		reg = <0x00 0xd0a0000 0x00 0x10000>;
		interrupts = <0x00 0x8c 0x08>;
	};

	dbg_mdsys1@0d0c0000 {
		compatible = "mediatek,dbg_mdsys1";
		reg = <0x00 0xd0c0000 0x00 0x40000>;
	};

	dbg_apmcu_mp0@0d400000 {
		compatible = "mediatek,dbg_apmcu_mp0";
		reg = <0x00 0xd400000 0x00 0x1000>;
	};

	dbg_apmcu_mp0@0d410000 {
		compatible = "mediatek,dbg_apmcu_mp0";
		reg = <0x00 0xd410000 0x00 0x1000>;
	};

	dbg_apmcu_mp0@0d420000 {
		compatible = "mediatek,dbg_apmcu_mp0";
		reg = <0x00 0xd420000 0x00 0x1000>;
	};

	dbg_apmcu_mp0@0d430000 {
		compatible = "mediatek,dbg_apmcu_mp0";
		reg = <0x00 0xd430000 0x00 0x1000>;
	};

	dbg_apmcu_mp0@0d440000 {
		compatible = "mediatek,dbg_apmcu_mp0";
		reg = <0x00 0xd440000 0x00 0x1000>;
	};

	dbg_apmcu_mp0@0d510000 {
		compatible = "mediatek,dbg_apmcu_mp0";
		reg = <0x00 0xd510000 0x00 0x1000>;
	};

	dbg_apmcu_mp0@0d520000 {
		compatible = "mediatek,dbg_apmcu_mp0";
		reg = <0x00 0xd520000 0x00 0x1000>;
	};

	dbg_apmcu_mp0@0d530000 {
		compatible = "mediatek,dbg_apmcu_mp0";
		reg = <0x00 0xd530000 0x00 0x1000>;
	};

	dbg_apmcu_mp0@0d540000 {
		compatible = "mediatek,dbg_apmcu_mp0";
		reg = <0x00 0xd540000 0x00 0x1000>;
	};

	dbg_apmcu_mp0@0d610000 {
		compatible = "mediatek,dbg_apmcu_mp0";
		reg = <0x00 0xd610000 0x00 0x1000>;
	};

	dbg_apmcu_mp0@0d620000 {
		compatible = "mediatek,dbg_apmcu_mp0";
		reg = <0x00 0xd620000 0x00 0x1000>;
	};

	dbg_apmcu_mp0@0d630000 {
		compatible = "mediatek,dbg_apmcu_mp0";
		reg = <0x00 0xd630000 0x00 0x1000>;
	};

	dbg_apmcu_mp0@0d640000 {
		compatible = "mediatek,dbg_apmcu_mp0";
		reg = <0x00 0xd640000 0x00 0x1000>;
	};

	dbg_apmcu_mp0@0d710000 {
		compatible = "mediatek,dbg_apmcu_mp0";
		reg = <0x00 0xd710000 0x00 0x1000>;
	};

	dbg_apmcu_mp0@0d720000 {
		compatible = "mediatek,dbg_apmcu_mp0";
		reg = <0x00 0xd720000 0x00 0x1000>;
	};

	dbg_apmcu_mp0@0d730000 {
		compatible = "mediatek,dbg_apmcu_mp0";
		reg = <0x00 0xd730000 0x00 0x1000>;
	};

	dbg_apmcu_mp0@0d740000 {
		compatible = "mediatek,dbg_apmcu_mp0";
		reg = <0x00 0xd740000 0x00 0x1000>;
	};

	dbg_apmcu_mp1@0d800000 {
		compatible = "mediatek,dbg_apmcu_mp1";
		reg = <0x00 0xd800000 0x00 0x1000>;
	};

	dbg_apmcu_mp1@0d810000 {
		compatible = "mediatek,dbg_apmcu_mp1";
		reg = <0x00 0xd810000 0x00 0x1000>;
	};

	dbg_apmcu_mp1@0d820000 {
		compatible = "mediatek,dbg_apmcu_mp1";
		reg = <0x00 0xd820000 0x00 0x1000>;
	};

	dbg_apmcu_mp1@0d830000 {
		compatible = "mediatek,dbg_apmcu_mp1";
		reg = <0x00 0xd830000 0x00 0x1000>;
	};

	dbg_apmcu_mp1@0d840000 {
		compatible = "mediatek,dbg_apmcu_mp1";
		reg = <0x00 0xd840000 0x00 0x1000>;
	};

	dbg_apmcu_mp1@0d910000 {
		compatible = "mediatek,dbg_apmcu_mp1";
		reg = <0x00 0xd910000 0x00 0x1000>;
	};

	dbg_apmcu_mp1@0d920000 {
		compatible = "mediatek,dbg_apmcu_mp1";
		reg = <0x00 0xd920000 0x00 0x1000>;
	};

	dbg_apmcu_mp1@0d930000 {
		compatible = "mediatek,dbg_apmcu_mp1";
		reg = <0x00 0xd930000 0x00 0x1000>;
	};

	dbg_apmcu_mp1@0d940000 {
		compatible = "mediatek,dbg_apmcu_mp1";
		reg = <0x00 0xd940000 0x00 0x1000>;
	};

	dbg_apmcu_mp1@0da10000 {
		compatible = "mediatek,dbg_apmcu_mp1";
		reg = <0x00 0xda10000 0x00 0x1000>;
	};

	dbg_apmcu_mp1@0da20000 {
		compatible = "mediatek,dbg_apmcu_mp1";
		reg = <0x00 0xda20000 0x00 0x1000>;
	};

	dbg_apmcu_mp1@0da30000 {
		compatible = "mediatek,dbg_apmcu_mp1";
		reg = <0x00 0xda30000 0x00 0x1000>;
	};

	dbg_apmcu_mp1@0da40000 {
		compatible = "mediatek,dbg_apmcu_mp1";
		reg = <0x00 0xda40000 0x00 0x1000>;
	};

	dbg_apmcu_mp1@0db10000 {
		compatible = "mediatek,dbg_apmcu_mp1";
		reg = <0x00 0xdb10000 0x00 0x1000>;
	};

	dbg_apmcu_mp1@0db20000 {
		compatible = "mediatek,dbg_apmcu_mp1";
		reg = <0x00 0xdb20000 0x00 0x1000>;
	};

	dbg_apmcu_mp1@0db30000 {
		compatible = "mediatek,dbg_apmcu_mp1";
		reg = <0x00 0xdb30000 0x00 0x1000>;
	};

	dbg_apmcu_mp1@0db40000 {
		compatible = "mediatek,dbg_apmcu_mp1";
		reg = <0x00 0xdb40000 0x00 0x1000>;
	};

	ap_dma@11000000 {
		compatible = "mediatek,ap_dma";
		reg = <0x00 0x11000000 0x00 0x1000>;
		interrupts = <0x00 0x61 0x08>;
	};

	auxadc@11001000 {
		compatible = "mediatek,auxadc";
		reg = <0x00 0x11001000 0x00 0x10000>;
		interrupts = <0x00 0x4c 0x02>;
		clocks = <0x25 0x21>;
		clock-names = "auxadc-main";
		linux,phandle = <0x80>;
		phandle = <0x80>;
	};

	dma-controller@11000580 {
		compatible = "mediatek,mt6577-uart-dma";
		reg = <0x00 0x11000680 0x00 0x80 0x00 0x11000700 0x00 0x80 0x00 0x11000780 0x00 0x80 0x00 0x11000800 0x00 0x80>;
		interrupts = <0x00 0x6d 0x08 0x00 0x6e 0x08 0x00 0x6f 0x08 0x00 0x74 0x08>;
		clocks = <0x25 0x26>;
		clock-names = "apdma";
		#dma-cells = <0x01>;
		linux,phandle = <0x32>;
		phandle = <0x32>;
	};

	serial@11020000 {
		compatible = "mediatek,mt6758-uart\0mediatek,mt6577-uart";
		reg = <0x00 0x11002000 0x00 0x1000>;
		interrupts = <0x00 0x5b 0x08>;
		clocks = <0x1f 0x25 0x16>;
		clock-names = "baud\0bus";
		dmas = <0x32 0x00 0x32 0x01>;
		dma-names = "tx\0rx";
		linux,phandle = <0x81>;
		phandle = <0x81>;
	};

	serial@11030000 {
		compatible = "mediatek,mt6758-uart\0mediatek,mt6577-uart";
		reg = <0x00 0x11003000 0x00 0x1000>;
		interrupts = <0x00 0x5c 0x08>;
		clocks = <0x1f 0x25 0x17>;
		clock-names = "baud\0bus";
		linux,phandle = <0x82>;
		phandle = <0x82>;
	};

	i2c_common {
		compatible = "mediatek,i2c_common";
		dma_support = [02];
		idvfs = [01];
		set_dt_div = [01];
		check_max_freq = [01];
		ver = [02];
		set_ltiming = [01];
		ext_time_config = [18 01];
		cnt_constraint = [01];
		linux,phandle = <0x83>;
		phandle = <0x83>;
	};

	i2c0@11007000 {
		compatible = "mediatek,i2c";
		id = <0x00>;
		reg = <0x00 0x11007000 0x00 0x1000 0x00 0x11000080 0x00 0x80>;
		interrupts = <0x00 0x54 0x08>;
		clocks = <0x25 0x0b 0x25 0x26>;
		clock-names = "main\0dma";
		clock-div = <0x05>;
		scl-gpio-id = <0x53>;
		sda-gpio-id = <0x52>;
		gpio_start = <0x10002a00>;
		mem_len = <0x200>;
		eh_cfg = <0x20>;
		pu_cfg = <0x50>;
		rsel_cfg = <0x70>;
		aed = <0x1a>;
		mediatek,hs_only;
		linux,phandle = <0x84>;
		phandle = <0x84>;
	};

	i2c1@11008000 {
		compatible = "mediatek,i2c";
		id = <0x01>;
		reg = <0x00 0x11008000 0x00 0x1000 0x00 0x11000100 0x00 0x80>;
		interrupts = <0x00 0x55 0x08>;
		clocks = <0x25 0x0b 0x25 0x26>;
		clock-names = "main\0dma";
		clock-div = <0x05>;
		scl-gpio-id = <0x54>;
		sda-gpio-id = <0x51>;
		gpio_start = <0x10002a00>;
		mem_len = <0x200>;
		eh_cfg = <0x20>;
		pu_cfg = <0x50>;
		rsel_cfg = <0x70>;
		aed = <0x1a>;
		mediatek,hs_only;
		linux,phandle = <0x85>;
		phandle = <0x85>;
	};

	i2c2@11009000 {
		compatible = "mediatek,i2c";
		id = <0x02>;
		reg = <0x00 0x11009000 0x00 0x1000 0x00 0x11000180 0x00 0x180>;
		interrupts = <0x00 0x56 0x08>;
		clocks = <0x25 0x0b 0x25 0x26>;
		clock-names = "main\0dma";
		clock-div = <0x05>;
		scl-gpio-id = <0x67>;
		sda-gpio-id = <0x68>;
		gpio_start = <0x10002800>;
		mem_len = <0x200>;
		eh_cfg = <0x20>;
		pu_cfg = <0x60>;
		rsel_cfg = <0xa0>;
		aed = <0x1a>;
		ch_offset_default = <0x100>;
		ch_offset_ccu = <0x200>;
		mediatek,hs_only;
		linux,phandle = <0x86>;
		phandle = <0x86>;
	};

	i2c3@1100f000 {
		compatible = "mediatek,i2c";
		id = <0x03>;
		reg = <0x00 0x1100f000 0x00 0x1000 0x00 0x11000300 0x00 0x100>;
		interrupts = <0x00 0x57 0x08>;
		clocks = <0x25 0x0b 0x25 0x26>;
		clock-names = "main\0dma";
		clock-div = <0x05>;
		scl-gpio-id = <0x32>;
		sda-gpio-id = <0x33>;
		gpio_start = <0x10002600>;
		mem_len = <0x200>;
		eh_cfg = <0x20>;
		pu_cfg = <0x90>;
		rsel_cfg = <0xb0>;
		aed = <0x1a>;
		ch_offset_default = <0x100>;
		mediatek,hs_only;
		linux,phandle = <0x87>;
		phandle = <0x87>;
	};

	i2c4@11011000 {
		compatible = "mediatek,i2c";
		id = <0x04>;
		reg = <0x00 0x11011000 0x00 0x1000 0x00 0x11000400 0x00 0x180>;
		interrupts = <0x00 0x58 0x08>;
		clocks = <0x25 0x0b 0x25 0x26>;
		clock-names = "main\0dma";
		clock-div = <0x05>;
		scl-gpio-id = <0x69>;
		sda-gpio-id = <0x6a>;
		gpio_start = <0x10002800>;
		mem_len = <0x200>;
		eh_cfg = <0x20>;
		pu_cfg = <0x60>;
		rsel_cfg = <0xa0>;
		aed = <0x1a>;
		ch_offset_default = <0x100>;
		ch_offset_ccu = <0x200>;
		mediatek,hs_only;
		linux,phandle = <0x88>;
		phandle = <0x88>;
	};

	i2c5@11016000 {
		compatible = "mediatek,i2c";
		id = <0x05>;
		reg = <0x00 0x11016000 0x00 0x1000 0x00 0x11000580 0x00 0x80>;
		interrupts = <0x00 0x82 0x08>;
		clocks = <0x25 0x0b 0x25 0x26>;
		clock-names = "main\0dma";
		clock-div = <0x05>;
		scl-gpio-id = <0x30>;
		sda-gpio-id = <0x31>;
		gpio_start = <0x10002600>;
		mem_len = <0x200>;
		eh_cfg = <0x20>;
		pu_cfg = <0x90>;
		rsel_cfg = <0xb0>;
		aed = <0x1a>;
		mediatek,hs_only;
		linux,phandle = <0x89>;
		phandle = <0x89>;
	};

	i2c6@1100d000 {
		compatible = "mediatek,i2c";
		id = <0x06>;
		reg = <0x00 0x1100d000 0x00 0x1000 0x00 0x11000600 0x00 0x80>;
		interrupts = <0x00 0x83 0x08>;
		clocks = <0x25 0x0b 0x25 0x26>;
		clock-names = "main\0dma";
		clock-div = <0x05>;
		scl-gpio-id = <0xa1>;
		sda-gpio-id = <0xa2>;
		gpio_start = <0x10002c00>;
		mem_len = <0x200>;
		eh_cfg = <0x20>;
		pu_cfg = <0x50>;
		rsel_cfg = <0x70>;
		aed = <0x1a>;
		ch_offset_default = <0x100>;
		ch_offset_ccu = <0x200>;
		mediatek,hs_only;
		linux,phandle = <0x8a>;
		phandle = <0x8a>;
	};

	pwm@11006000 {
		compatible = "mediatek,pwm";
		reg = <0x00 0x11006000 0x00 0x10000>;
		interrupts = <0x00 0x4d 0x08>;
		clocks = <0x25 0x10 0x25 0x11 0x25 0x12 0x25 0x13 0x25 0x14 0x25 0x30 0x25 0x0f 0x25 0x15>;
		clock-names = "PWM1-main\0PWM2-main\0PWM3-main\0PWM4-main\0PWM5-main\0PWM6-main\0PWM-HCLK-main\0PWM-main";
		linux,phandle = <0x8b>;
		phandle = <0x8b>;
	};

	spi@1100a000 {
		compatible = "mediatek,mt6765-spi";
		mediatek,pad-select = <0x00>;
		reg = <0x00 0x1100a000 0x00 0x1000>;
		interrupts = <0x00 0x76 0x08>;
		clocks = <0x1e 0x0b 0x1e 0x6b 0x25 0x1b>;
		clock-names = "parent-clk\0sel-clk\0spi-clk";
		linux,phandle = <0x8c>;
		phandle = <0x8c>;
	};

	therm_ctrl@1100b000 {
		compatible = "mediatek,therm_ctrl";
		reg = <0x00 0x1100b000 0x00 0x1000>;
		interrupts = <0x00 0x4e 0x08>;
		clocks = <0x25 0x0a>;
		clock-names = "therm-main";
	};

	btif@1100c000 {
		compatible = "mediatek,btif";
		reg = <0x00 0x1100c000 0x00 0x1000 0x00 0x11000880 0x00 0x80 0x00 0x11000900 0x00 0x80>;
		interrupts = <0x00 0x70 0x08 0x00 0x84 0x08 0x00 0x85 0x08>;
		clocks = <0x25 0x1a 0x25 0x26>;
		clock-names = "btifc\0apdmac";
	};

	consys@18002000 {
		compatible = "mediatek,mt6765-consys";
		#address-cells = <0x02>;
		#size-cells = <0x02>;
		reg = <0x00 0x18002000 0x00 0x1000 0x00 0x10007000 0x00 0x100 0x00 0x10001000 0x00 0x1000 0x00 0x10006000 0x00 0x1000 0x00 0x18007000 0x00 0x1000 0x00 0x180b1000 0x00 0x1000 0x00 0x180a3000 0x00 0x1000 0x00 0x180a5000 0x00 0x800 0x00 0x180c1000 0x00 0x1000 0x00 0x18004000 0x00 0x1000 0x00 0x00 0x00 0x00 0x00 0x00 0x00 0x00 0x00 0x1020e000 0x00 0x1000>;
		interrupts = <0x00 0x10b 0x08 0x00 0x10d 0x08 0x00 0x10e 0x01>;
		clocks = <0x26 0x01>;
		clock-names = "conn";
		linux,phandle = <0x1b>;
		phandle = <0x1b>;
	};

	wifi@18000000 {
		compatible = "mediatek,wifi";
		reg = <0x00 0x18000000 0x00 0x100000>;
		interrupts = <0x00 0x10c 0x08>;
	};

	disp_pwm@1100e000 {
		compatible = "mediatek,disp_pwm";
		reg = <0x00 0x1100e000 0x00 0x1000>;
	};

	spi@11010000 {
		compatible = "mediatek,mt6765-spi\0mediatek,mt6765-spi-fp";
		mediatek,pad-select = <0x00>;
		reg = <0x00 0x11010000 0x00 0x1000>;
		interrupts = <0x00 0x7a 0x08>;
		clocks = <0x1e 0x0b 0x1e 0x6b 0x25 0x34>;
		clock-names = "parent-clk\0sel-clk\0spi-clk";
		linux,phandle = <0x8d>;
		phandle = <0x8d>;
	};

	spi@11012000 {
		compatible = "mediatek,mt6765-spi";
		mediatek,pad-select = <0x00>;
		reg = <0x00 0x11012000 0x00 0x1000>;
		interrupts = <0x00 0x80 0x08>;
		clocks = <0x1e 0x0b 0x1e 0x6b 0x25 0x37>;
		clock-names = "parent-clk\0sel-clk\0spi-clk";
		linux,phandle = <0x8e>;
		phandle = <0x8e>;
	};

	spi@11013000 {
		compatible = "mediatek,mt6765-spi";
		mediatek,pad-select = <0x00>;
		reg = <0x00 0x11013000 0x00 0x1000>;
		interrupts = <0x00 0x81 0x08>;
		clocks = <0x1e 0x0b 0x1e 0x6b 0x25 0x38>;
		clock-names = "parent-clk\0sel-clk\0spi-clk";
		linux,phandle = <0x8f>;
		phandle = <0x8f>;
	};

	spi@11014000 {
		compatible = "mediatek,mt6765-spi";
		mediatek,pad-select = <0x00>;
		reg = <0x00 0x11014000 0x00 0x1000>;
		interrupts = <0x00 0x5f 0x08>;
		clocks = <0x1e 0x0b 0x1e 0x6b 0x25 0x41>;
		clock-names = "parent-clk\0sel-clk\0spi-clk";
		linux,phandle = <0x90>;
		phandle = <0x90>;
	};

	spi@11015000 {
		compatible = "mediatek,mt6765-spi";
		mediatek,pad-select = <0x00>;
		reg = <0x00 0x11015000 0x00 0x1000>;
		interrupts = <0x00 0x60 0x08>;
		clocks = <0x1e 0x0b 0x1e 0x6b 0x25 0x42>;
		clock-names = "parent-clk\0sel-clk\0spi-clk";
		linux,phandle = <0x91>;
		phandle = <0x91>;
	};

	imp_iic@11017000 {
		compatible = "mediatek,imp_iic";
		reg = <0x00 0x11017000 0x00 0x1000>;
	};

	nfi@11018000 {
		compatible = "mediatek,nfi";
		reg = <0x00 0x11018000 0x00 0x1000>;
	};

	nfiecc@11019000 {
		compatible = "mediatek,nfiecc";
		reg = <0x00 0x11019000 0x00 0x1000>;
	};

	usb0@11200000 {
		compatible = "mediatek,mt6765-usb20";
		reg = <0x00 0x11200000 0x00 0x10000 0x00 0x11cc0000 0x00 0x10000>;
		interrupts = <0x00 0x49 0x08>;
		mode = <0x02>;
		multipoint = <0x01>;
		num_eps = <0x10>;
		clocks = <0x25 0x08 0x1e 0x76 0x1e 0x20>;
		clock-names = "usb0\0usb0_clk_top_sel\0usb0_clk_univpll3_d4";
	};

	usb_sif@11210000 {
		compatible = "mediatek,usb_sif";
		reg = <0x00 0x11210000 0x00 0x10000>;
	};

	msdc@11230000 {
		compatible = "mediatek,msdc";
		reg = <0x00 0x11230000 0x00 0x10000>;
		interrupts = <0x00 0x4f 0x08>;
		index = [00];
		clk_src = [01];
		bus-width = <0x08>;
		max-frequency = <0xbebc200>;
		cap-mmc-highspeed;
		mmc-ddr-1_8v;
		mmc-hs200-1_8v;
		mmc-hs400-1_8v;
		no-sd;
		no-sdio;
		non-removable;
		pinctl = <0x33>;
		pinctl_hs400 = <0x34>;
		pinctl_hs200 = <0x35>;
		register_setting = <0x36>;
		host_function = [00];
		bootable;
		status = "okay";
		vmmc-supply = <0x37>;
		clocks = <0x25 0x4c 0x25 0x1c 0x25 0x44>;
		clock-names = "msdc0-clock\0msdc0-hclock\0msdc0-aes-clock";
		linux,phandle = <0x92>;
		phandle = <0x92>;
	};

	msdc@11240000 {
		compatible = "mediatek,msdc";
		reg = <0x00 0x11240000 0x00 0x10000>;
		interrupts = <0x00 0x50 0x08>;
		index = [01];
		clk_src = [02];
		bus-width = <0x04>;
		max-frequency = <0xbebc200>;
		cap-sd-highspeed;
		sd-uhs-sdr12;
		sd-uhs-sdr25;
		sd-uhs-sdr50;
		sd-uhs-sdr104;
		sd-uhs-ddr50;
		no-mmc;
		no-sdio;
		pinctl = <0x38>;
		pinctl_sdr104 = <0x39>;
		pinctl_sdr50 = <0x3a>;
		pinctl_ddr50 = <0x3b>;
		register_setting = <0x3c>;
		host_function = [01];
		cd_level = [01];
		cd-gpios = <0x20 0x01 0x00>;
		status = "okay";
		vmmc-supply = <0x3d>;
		vqmmc-supply = <0x3e>;
		clocks = <0x25 0x4d 0x25 0x1d>;
		clock-names = "msdc1-clock\0msdc1-hclock";
		linux,phandle = <0x93>;
		phandle = <0x93>;
	};

	msdc@11250000 {
		compatible = "mediatek,msdc2";
		reg = <0x00 0x11250000 0x00 0x10000>;
		status = "disable";
		linux,phandle = <0x94>;
		phandle = <0x94>;
	};

	msdc@11260000 {
		compatible = "mediatek,msdc3";
		reg = <0x00 0x11250000 0x00 0x10000>;
		status = "disable";
		linux,phandle = <0x95>;
		phandle = <0x95>;
	};

	msdc1_ins@0 {
		compatible = "mediatek,mt6765-sdcard-ins";
		linux,phandle = <0x96>;
		phandle = <0x96>;
	};

	msdc0_top@11cd0000 {
		compatible = "mediatek,msdc0_top";
		reg = <0x00 0x11cd0000 0x00 0x1000>;
	};

	msdc1_top@11c90000 {
		compatible = "mediatek,msdc1_top";
		reg = <0x00 0x11c90000 0x00 0x1000>;
	};

	usb1p_sif@11210000 {
		compatible = "mediatek,usb1p_sif";
		reg = <0x00 0x11210000 0x00 0x10000>;
	};

	audio@11220000 {
		compatible = "mediatek,audio\0syscon";
		reg = <0x00 0x11220000 0x00 0x1000>;
		#clock-cells = <0x01>;
		mediatek,btcvsd_snd = <0x3f>;
		linux,phandle = <0x40>;
		phandle = <0x40>;
	};

	mt_soc_dl1_pcm@11220000 {
		compatible = "mediatek,mt_soc_pcm_dl1";
		reg = <0x00 0x11220000 0x00 0x1000>;
		interrupts = <0x00 0x99 0x08>;
		clocks = <0x40 0x00 0x40 0x04 0x40 0x05 0x40 0x03 0x40 0x01 0x40 0x02 0x40 0x06 0x25 0x2b 0x25 0x33 0x1e 0x6f 0x1e 0x70 0x1e 0x03 0x1e 0x71 0x1e 0x29 0x1e 0x72 0x1e 0x2c 0x41 0x08 0x1f>;
		clock-names = "aud_afe_clk\0aud_dac_clk\0aud_dac_predis_clk\0aud_adc_clk\0aud_apll22m_clk\0aud_apll1_tuner_clk\0aud_tml_clk\0aud_infra_clk\0mtkaif_26m_clk\0top_mux_audio\0top_mux_audio_int\0top_sys_pll1_d4\0top_mux_aud_1\0top_apll1_ck\0top_mux_aud_eng1\0top_apll1_d8\0apmixed_apll1\0top_clk26m_clk";
		linux,phandle = <0x97>;
		phandle = <0x97>;
	};

	audio_sram@11221000 {
		compatible = "mediatek,audio_sram";
		reg = <0x00 0x11221000 0x00 0x9000>;
	};

	mtk-btcvsd-snd@18050000 {
		compatible = "mediatek,mtk-btcvsd-snd";
		reg = <0x00 0x18050000 0x00 0x1000 0x00 0x18080000 0x00 0x10000>;
		interrupts = <0x00 0x10a 0x08>;
		mediatek,infracfg = <0x25>;
		mediatek,offset = <0xf00 0x800 0x140 0x144 0x148>;
		linux,phandle = <0x3f>;
		phandle = <0x3f>;
	};

	mipi_rx_ana_csi0a@11c10000 {
		compatible = "mediatek,mipi_rx_ana_csi0a\0syscon";
		reg = <0x00 0x11c10000 0x00 0x1000>;
		#clock-cells = <0x01>;
		linux,phandle = <0x45>;
		phandle = <0x45>;
	};

	mipi_rx_ana_csi0b@11c11000 {
		compatible = "mediatek,mipi_rx_ana_csi0b\0syscon";
		reg = <0x00 0x11c11000 0x00 0x1000>;
		#clock-cells = <0x01>;
		linux,phandle = <0x46>;
		phandle = <0x46>;
	};

	mipi_rx_ana_csi1a@11c12000 {
		compatible = "mediatek,mipi_rx_ana_csi1a\0syscon";
		reg = <0x00 0x11c12000 0x00 0x1000>;
		#clock-cells = <0x01>;
		linux,phandle = <0x47>;
		phandle = <0x47>;
	};

	mipi_rx_ana_csi1b@11c13000 {
		compatible = "mediatek,mipi_rx_ana_csi1b\0syscon";
		reg = <0x00 0x11c13000 0x00 0x1000>;
		#clock-cells = <0x01>;
		linux,phandle = <0x48>;
		phandle = <0x48>;
	};

	mipi_rx_ana_csi2a@11c14000 {
		compatible = "mediatek,mipi_rx_ana_csi2a\0syscon";
		reg = <0x00 0x11c14000 0x00 0x1000>;
		#clock-cells = <0x01>;
		linux,phandle = <0x49>;
		phandle = <0x49>;
	};

	mipi_rx_ana_csi2b@11c15000 {
		compatible = "mediatek,mipi_rx_ana_csi2b\0syscon";
		reg = <0x00 0x11c15000 0x00 0x1000>;
		#clock-cells = <0x01>;
		linux,phandle = <0x4a>;
		phandle = <0x4a>;
	};

	efusec@11c50000 {
		compatible = "mediatek,efusec";
		reg = <0x00 0x11c50000 0x00 0x10000>;
	};

	mipi_tx0@11c80000 {
		compatible = "mediatek,mipi_tx0";
		reg = <0x00 0x11c80000 0x00 0x10000>;
	};

	msdc1_pad_macro@11c90000 {
		compatible = "mediatek,msdc1_pad_macro";
		reg = <0x00 0x11c90000 0x00 0x10000>;
	};

	msdc0_pad_macro@11cd0000 {
		compatible = "mediatek,msdc0_pad_macro";
		reg = <0x00 0x11cd0000 0x00 0x10000>;
	};

	mfg_doma@13000000 {
		compatible = "mediatek,doma";
		reg = <0x00 0x13000000 0x00 0x80000>;
		interrupts = <0x00 0x103 0x08>;
		interrupt-names = "RGX";
		clock-frequency = <0x21f98280>;
	};

	mfg_cfg@13ffe000 {
		compatible = "mediatek,mfgcfg\0syscon";
		reg = <0x00 0x13ffe000 0x00 0x1000>;
		#clock-cells = <0x01>;
		linux,phandle = <0x98>;
		phandle = <0x98>;
	};

	gpufreq {
		compatible = "mediatek,mt6765-gpufreq";
		clocks = <0x1e 0x64 0x1e 0x26 0x1f 0x26 0x08 0x26 0x04 0x26 0x07>;
		clock-names = "clk_mux\0clk_main_parent\0clk_sub_parent\0mtcmos_mfg_async\0mtcmos_mfg\0mtcmos_mfg_core0";
	};

	mmsys_config@14000000 {
		compatible = "mediatek,mmsys_config\0syscon";
		reg = <0x00 0x14000000 0x00 0x1000>;
		interrupts = <0x00 0xe3 0x08>;
		#clock-cells = <0x01>;
		clocks = <0x27 0x17 0x27 0x1a 0x27 0x1b>;
		clock-names = "CAM_MDP\0IMG_DL_RELAY\0IMG_DL_ASYNC_TOP";
		linux,phandle = <0x27>;
		phandle = <0x27>;
	};

	nfc {
		compatible = "mediatek,nfc-gpio-v2";
		gpio-rst = <0xac>;
		gpio-rst-std = <0x20 0xac 0x00>;
		gpio-irq = <0x0a>;
		gpio-irq-std = <0x20 0x0a 0x00>;
		linux,phandle = <0x99>;
		phandle = <0x99>;
	};

	irq_nfc {
		compatible = "mediatek,irq_nfc-eint";
		linux,phandle = <0x9a>;
		phandle = <0x9a>;
	};

	disp_mutex0@14001000 {
		compatible = "mediatek,disp_mutex0";
		reg = <0x00 0x14001000 0x00 0x1000>;
		interrupts = <0x00 0xd2 0x08>;
		linux,phandle = <0x30>;
		phandle = <0x30>;
	};

	smi_common@14002000 {
		compatible = "mediatek,smi_common";
		reg = <0x00 0x14002000 0x00 0x1000>;
		nr_larbs = <0x04>;
		larbs = <0x21 0x22 0x23 0x24>;
		mmsys_config = <0x27>;
		clocks = <0x26 0x03 0x27 0x15 0x27 0x16 0x27 0x13 0x1e 0x62 0x1e 0x21 0x1e 0x17 0x1e 0x22>;
		clock-names = "mtcmos-mm\0smi-common-gals-comm0\0smi-common-gals-comm1\0smi-common\0mmdvfs_clk_mm_sel_ck\0mmdvfs_clk_mmpll_ck\0mmdvfs_clk_univpll1_d2_ck\0mmdvfs_clk_mmpll_d2_ck";
	};

	mmdvfs_pmqos {
		compatible = "mediatek,mmdvfs_pmqos";
		mm_step0 = <0x1c9 0x01 0x00 0x01>;
		mm_step1 = <0x138 0x01 0x00 0x02>;
		mm_step2 = <0xe4 0x01 0x00 0x03>;
		vopp_steps = <0x00 0x01 0x03>;
		disp_freq = "mm_step0\0mm_step1\0mm_step2";
		mdp_freq = "mm_step0\0mm_step1\0mm_step2";
		cam_freq = "mm_step0\0mm_step1\0mm_step2";
		img_freq = "mm_step0\0mm_step1\0mm_step2";
		vdec_freq = "mm_step0\0mm_step1\0mm_step2";
		venc_freq = "mm_step0\0mm_step1\0mm_step2";
		clocks = <0x1e 0x62 0x1e 0x21 0x1e 0x17 0x1e 0x22>;
		clock-names = "mmdvfs_clk_mm_sel_ck\0mmdvfs_clk_mmpll_ck\0mmdvfs_clk_univpll1_d2_ck\0mmdvfs_clk_mmpll_d2_ck";
	};

	imgsys@15020000 {
		compatible = "mediatek,imgsys\0syscon";
		reg = <0x00 0x15020000 0x00 0x1000>;
		#clock-cells = <0x01>;
		clocks = <0x26 0x03 0x26 0x05 0x26 0x09 0x42 0x01 0x43 0x02 0x43 0x03 0x43 0x04 0x43 0x05 0x43 0x06 0x43 0x07>;
		clock-names = "ISP_SCP_SYS_DIS\0ISP_SCP_SYS_ISP\0ISP_SCP_SYS_CAM\0ISP_CLK_IMG_DIP\0ISP_CLK_CAM\0ISP_CLK_CAMTG\0ISP_CLK_CAM_SENINF\0ISP_CLK_CAMSV0\0ISP_CLK_CAMSV1\0ISP_CLK_CAMSV2";
		linux,phandle = <0x42>;
		phandle = <0x42>;
	};

	dip1@15022000 {
		compatible = "mediatek,dip1";
		reg = <0x00 0x15022000 0x00 0x3000>;
		interrupts = <0x00 0xff 0x08>;
	};

	dpe@15028000 {
		compatible = "mediatek,dpe";
		reg = <0x00 0x15028000 0x00 0x1000>;
		interrupts = <0x00 0x100 0x08>;
		clocks = <0x42 0x03>;
		clock-names = "DPE_CG_IMG_DPE";
	};

	smi_larb0@14003000 {
		cell-index = <0x00>;
		compatible = "mediatek,smi_larb0\0mediatek,smi_larb";
		reg = <0x00 0x14003000 0x00 0x1000>;
		clocks = <0x26 0x03 0x27 0x14>;
		clock-names = "mtcmos-mm\0mm-larb0";
		linux,phandle = <0x21>;
		phandle = <0x21>;
	};

	mdp_rdma0@14004000 {
		compatible = "mediatek,mdp_rdma0";
		reg = <0x00 0x14004000 0x00 0x1000>;
		interrupts = <0x00 0xd3 0x08>;
		clocks = <0x27 0x00>;
		clock-names = "MDP_RDMA0";
		linux,phandle = <0x28>;
		phandle = <0x28>;
	};

	mdp_ccorr0@14005000 {
		compatible = "mediatek,mdp_ccorr0";
		reg = <0x00 0x14005000 0x00 0x1000>;
		interrupts = <0x00 0xe2 0x08>;
		clocks = <0x27 0x01>;
		clock-names = "MDP_CCORR";
		linux,phandle = <0x2f>;
		phandle = <0x2f>;
	};

	mdp_rsz0@14006000 {
		compatible = "mediatek,mdp_rsz0";
		reg = <0x00 0x14006000 0x00 0x1000>;
		interrupts = <0x00 0xd4 0x08>;
		clocks = <0x27 0x02>;
		clock-names = "MDP_RSZ0";
		linux,phandle = <0x29>;
		phandle = <0x29>;
	};

	mdp_rsz1@14007000 {
		compatible = "mediatek,mdp_rsz1";
		reg = <0x00 0x14007000 0x00 0x1000>;
		interrupts = <0x00 0xd5 0x08>;
		clocks = <0x27 0x03>;
		clock-names = "MDP_RSZ1";
		linux,phandle = <0x2a>;
		phandle = <0x2a>;
	};

	mdp_wdma0@14008000 {
		compatible = "mediatek,mdp_wdma0";
		reg = <0x00 0x14008000 0x00 0x1000>;
		interrupts = <0x00 0xd8 0x08>;
		clocks = <0x27 0x06>;
		clock-names = "MDP_WDMA";
		linux,phandle = <0x2b>;
		phandle = <0x2b>;
	};

	mdp_wrot0@14009000 {
		compatible = "mediatek,mdp_wrot0";
		reg = <0x00 0x14009000 0x00 0x1000>;
		interrupts = <0x00 0xd7 0x08>;
		clocks = <0x27 0x05>;
		clock-names = "MDP_WROT0";
		linux,phandle = <0x2c>;
		phandle = <0x2c>;
	};

	mdp_tdshp0@1400a000 {
		compatible = "mediatek,mdp_tdshp0";
		reg = <0x00 0x1400a000 0x00 0x1000>;
		clocks = <0x27 0x04>;
		clock-names = "MDP_TDSHP";
		linux,phandle = <0x2d>;
		phandle = <0x2d>;
	};

	disp_ovl0@1400b000 {
		compatible = "mediatek,disp_ovl0";
		reg = <0x00 0x1400b000 0x00 0x1000>;
		interrupts = <0x00 0xd9 0x08>;
	};

	disp_ovl0_2l@1400c000 {
		compatible = "mediatek,disp_ovl0_2l";
		reg = <0x00 0x1400c000 0x00 0x1000>;
		interrupts = <0x00 0xe5 0x08>;
	};

	disp_rdma0@1400d000 {
		compatible = "mediatek,disp_rdma0";
		reg = <0x00 0x1400d000 0x00 0x1000>;
		interrupts = <0x00 0xda 0x08>;
	};

	disp_wdma0@1400e000 {
		compatible = "mediatek,disp_wdma0";
		reg = <0x00 0x1400e000 0x00 0x1000>;
		interrupts = <0x00 0xdb 0x08>;
	};

	disp_color0@1400f000 {
		compatible = "mediatek,disp_color0";
		reg = <0x00 0x1400f000 0x00 0x1000>;
		interrupts = <0x00 0xdc 0x08>;
		clocks = <0x27 0x0c>;
		clock-names = "MDP_COLOR";
		linux,phandle = <0x2e>;
		phandle = <0x2e>;
	};

	disp_ccorr0@14010000 {
		compatible = "mediatek,disp_ccorr0";
		reg = <0x00 0x14010000 0x00 0x1000>;
		interrupts = <0x00 0xdd 0x08>;
	};

	disp_aal0@14011000 {
		compatible = "mediatek,disp_aal0";
		reg = <0x00 0x14011000 0x00 0x1000>;
		interrupts = <0x00 0xde 0x08>;
	};

	disp_gamma0@14012000 {
		compatible = "mediatek,disp_gamma0";
		reg = <0x00 0x14012000 0x00 0x1000>;
		interrupts = <0x00 0xdf 0x08>;
	};

	disp_dither0@14013000 {
		compatible = "mediatek,disp_dither0";
		reg = <0x00 0x14013000 0x00 0x1000>;
		interrupts = <0x00 0xe0 0x08>;
	};

	dsi0@14014000 {
		compatible = "mediatek,dsi0";
		reg = <0x00 0x14014000 0x00 0x1000>;
		interrupts = <0x00 0xe1 0x08>;
	};

	disp_rsz0@14015000 {
		compatible = "mediatek,disp_rsz0";
		reg = <0x00 0x14015000 0x00 0x1000>;
		interrupts = <0x00 0x114 0x08>;
	};

	mtkfb@0 {
		compatible = "mediatek,mtkfb";
		linux,phandle = <0x9b>;
		phandle = <0x9b>;
	};

	dispsys {
		compatible = "mediatek,dispsys";
		mediatek,larb = <0x21>;
		clocks = <0x26 0x03 0x27 0x13 0x27 0x14 0x27 0x15 0x27 0x16 0x27 0x07 0x27 0x08 0x27 0x0a 0x27 0x0b 0x27 0x0c 0x27 0x0d 0x27 0x0e 0x27 0x0f 0x27 0x10 0x27 0x11 0x27 0x1c 0x27 0x1d 0x27 0x09 0x41 0x15 0x1e 0x73 0x25 0x31 0x1f 0x1e 0x1b 0x1e 0x2e 0x1e 0x30>;
		clock-names = "MMSYS_MTCMOS\0MMSYS_SMI_COMMON\0MMSYS_SMI_LARB0\0MMSYS_GALS_COMM0\0MMSYS_GALS_COMM1\0MMSYS_DISP_OVL0\0MMSYS_DISP_OVL0_2L\0MMSYS_DISP_RDMA0\0MMSYS_DISP_WDMA0\0MMSYS_DISP_COLOR0\0MMSYS_DISP_CCORR0\0MMSYS_DISP_AAL0\0MMSYS_DISP_GAMMA0\0MMSYS_DISP_DITHER0\0MMSYS_DSI0_MM_CK\0MMSYS_DSI0_IF_CK\0MMSYS_26M\0MMSYS_DISP_RSZ0\0APMIXED_MIPI_26M\0TOP_MUX_DISP_PWM\0DISP_PWM\0TOP_26M\0TOP_UNIVPLL2_D4\0TOP_ULPOSC1_D2\0TOP_ULPOSC1_D8";
	};

	dsi_te {
		compatible = "mediatek, DSI_TE-eint";
		status = "disabled";
		linux,phandle = <0x9c>;
		phandle = <0x9c>;
	};

	smi_larb2@15021000 {
		cell-index = <0x02>;
		compatible = "mediatek,smi_larb2\0mediatek,smi_larb";
		reg = <0x00 0x15021000 0x00 0x1000>;
		clocks = <0x26 0x05 0x27 0x18 0x42 0x00>;
		clock-names = "mtcmos-isp\0gals-img2mm\0img-larb2";
		linux,phandle = <0x23>;
		phandle = <0x23>;
	};

	fdvt@1502b000 {
		compatible = "mediatek,fdvt";
		reg = <0x00 0x1502b000 0x00 0x1000>;
		interrupts = <0x00 0x102 0x08>;
		clocks = <0x42 0x02>;
		clock-names = "FD_CLK_IMG_FDVT";
	};

	venc_gcon@17000000 {
		compatible = "mediatek,venc_gcon\0syscon";
		reg = <0x00 0x17000000 0x00 0x10000>;
		clocks = <0x26 0x03 0x26 0x0a 0x27 0x15 0x27 0x16 0x27 0x13 0x44 0x03 0x44 0x01>;
		clock-names = "MT_SCP_SYS_DIS\0MT_SCP_SYS_VCODEC\0MT_CG_MM_SMI_COMM0\0MT_CG_MM_SMI_COMM1\0MT_CG_MM_SMI_COMMON\0MT_CG_VDEC\0MT_CG_VENC";
		#clock-cells = <0x01>;
		linux,phandle = <0x44>;
		phandle = <0x44>;
	};

	smi_larb1@17010000 {
		cell-index = <0x01>;
		compatible = "mediatek,smi_larb1\0mediatek,smi_larb";
		reg = <0x00 0x17010000 0x00 0x1000>;
		clocks = <0x26 0x0a 0x44 0x01>;
		clock-names = "mtcmos-vcodec\0venc-larb1";
		linux,phandle = <0x22>;
		phandle = <0x22>;
	};

	venc@17020000 {
		compatible = "mediatek,venc";
		reg = <0x00 0x17020000 0x00 0x10000>;
		interrupts = <0x00 0xe6 0x08>;
	};

	venc_jpg@17030000 {
		compatible = "mediatek,venc_jpg";
		reg = <0x00 0x17030000 0x00 0x10000>;
		interrupts = <0x00 0xe8 0x08>;
		clocks = <0x44 0x02>;
		clock-names = "MT_CG_VENC_JPGENC";
	};

	vdec@17040000 {
		compatible = "mediatek,vdec";
		reg = <0x00 0x17040000 0x00 0x10000>;
		interrupts = <0x00 0xe9 0x08>;
	};

	mbist@17050000 {
		compatible = "mediatek,mbist";
		reg = <0x00 0x17050000 0x00 0x10000>;
	};

	camsys@1a000000 {
		compatible = "mediatek,camsys\0syscon";
		reg = <0x00 0x1a000000 0x00 0x1000>;
		#clock-cells = <0x01>;
		linux,phandle = <0x43>;
		phandle = <0x43>;
	};

	smi_larb3@1a002000 {
		cell-index = <0x03>;
		compatible = "mediatek,smi_larb3\0mediatek,smi_larb";
		reg = <0x00 0x1a002000 0x00 0x1000>;
		clocks = <0x26 0x09 0x27 0x19 0x43 0x00>;
		clock-names = "mtcmos-cam\0gals-cam2mm\0cam-larb3";
		linux,phandle = <0x24>;
		phandle = <0x24>;
	};

	cam1@1a003000 {
		compatible = "mediatek,cam1";
		reg = <0x00 0x1a003000 0x00 0x1000>;
		interrupts = <0x00 0xeb 0x08>;
	};

	cam2@1a004000 {
		compatible = "mediatek,cam2";
		reg = <0x00 0x1a004000 0x00 0x1000>;
		interrupts = <0x00 0xec 0x08>;
	};

	cam3@1a005000 {
		compatible = "mediatek,cam3";
		reg = <0x00 0x1a005000 0x00 0x1000>;
		interrupts = <0x00 0xed 0x08>;
	};

	cam_set@1a00b000 {
		compatible = "mediatek,cam_set";
		reg = <0x00 0x1a00b000 0x00 0x1000>;
	};

	cama_set@1a00c000 {
		compatible = "mediatek,cama_set";
		reg = <0x00 0x1a00c000 0x00 0x1000>;
	};

	camb_set@1a00d000 {
		compatible = "mediatek,camb_set";
		reg = <0x00 0x1a00d000 0x00 0x1000>;
	};

	cam_inner@1a013000 {
		compatible = "mediatek,cam_inner";
		reg = <0x00 0x1a013000 0x00 0x1000>;
	};

	cama_inner@1a014000 {
		compatible = "mediatek,cama_inner";
		reg = <0x00 0x1a014000 0x00 0x1000>;
	};

	camb_inner@1a015000 {
		compatible = "mediatek,camb_inner";
		reg = <0x00 0x1a015000 0x00 0x1000>;
	};

	cam_clear@1a01b000 {
		compatible = "mediatek,cam_clear";
		reg = <0x00 0x1a01b000 0x00 0x1000>;
	};

	cama_clear@1a01c000 {
		compatible = "mediatek,cama_clear";
		reg = <0x00 0x1a01c000 0x00 0x1000>;
	};

	camb_clear@1a01d000 {
		compatible = "mediatek,camb_clear";
		reg = <0x00 0x1a01d000 0x00 0x1000>;
	};

	cama_ext@1a024000 {
		compatible = "mediatek,cama_ext";
		reg = <0x00 0x1a024000 0x00 0x1000>;
	};

	camb_ext@1a025000 {
		compatible = "mediatek,camb_ext";
		reg = <0x00 0x1a025000 0x00 0x1000>;
	};

	seninf1@1a040000 {
		compatible = "mediatek,seninf1";
		reg = <0x00 0x1a040000 0x00 0x1000>;
	};

	seninf2@1a041000 {
		compatible = "mediatek,seninf2";
		reg = <0x00 0x1a041000 0x00 0x1000>;
	};

	seninf3@1a042000 {
		compatible = "mediatek,seninf3";
		reg = <0x00 0x1a042000 0x00 0x1000>;
	};

	seninf4@1a043000 {
		compatible = "mediatek,seninf4";
		reg = <0x00 0x1a043000 0x00 0x1000>;
	};

	kd_camera_hw1@1a040000 {
		compatible = "mediatek,camera_hw";
		reg = <0x00 0x1a040000 0x00 0x1000>;
		clocks = <0x1e 0x66 0x1e 0x67 0x1e 0x68 0x1e 0x69 0x1e 0x14 0x1e 0x13 0x1e 0x1d 0x1e 0x11 0x1e 0x1c 0x1e 0x12 0x1f 0x43 0x04 0x41 0x0e 0x41 0x12 0x45 0x00 0x46 0x00 0x47 0x00 0x48 0x00 0x49 0x00 0x4a 0x00 0x1e 0x7d 0x1e 0x1a 0x26 0x09>;
		clock-names = "CLK_TOP_CAMTG_SEL\0CLK_TOP_CAMTG1_SEL\0CLK_TOP_CAMTG2_SEL\0CLK_TOP_CAMTG3_SEL\0CLK_MCLK_6M\0CLK_MCLK_12M\0CLK_MCLK_13M\0CLK_MCLK_48M\0CLK_MCLK_52M\0CLK_MCLK_24M\0CLK_MCLK_26M\0CLK_CAM_SENINF_CG\0CLK_MIPI_C0_26M_CG\0CLK_MIPI_C1_26M_CG\0CLK_MIPI_ANA_0A_CG\0CLK_MIPI_ANA_0B_CG\0CLK_MIPI_ANA_1A_CG\0CLK_MIPI_ANA_1B_CG\0CLK_MIPI_ANA_2A_CG\0CLK_MIPI_ANA_2B_CG\0CLK_TOP_CAMTM_SEL_CG\0CLK_TOP_CAMTM_208_CG\0CLK_SCP_SYS_CAM";
		linux,phandle = <0x9d>;
		phandle = <0x9d>;
	};

	camsv1@1a050000 {
		compatible = "mediatek,camsv1";
		reg = <0x00 0x1a050000 0x00 0x1000>;
		interrupts = <0x00 0xf3 0x08>;
	};

	camsv2@1a051000 {
		compatible = "mediatek,camsv2";
		reg = <0x00 0x1a051000 0x00 0x1000>;
		interrupts = <0x00 0xf4 0x08>;
	};

	camsv3@1a052000 {
		compatible = "mediatek,camsv3";
		reg = <0x00 0x1a052000 0x00 0x1000>;
		interrupts = <0x00 0xf1 0x08>;
	};

	camsv4@1a053000 {
		compatible = "mediatek,camsv4";
		reg = <0x00 0x1a053000 0x00 0x1000>;
		interrupts = <0x00 0xf2 0x08>;
	};

	flashlight_core {
		compatible = "mediatek,flashlight_core";
		linux,phandle = <0x9e>;
		phandle = <0x9e>;
	};

	flashlights_dummy_gpio {
		compatible = "mediatek,flashlights_dummy_gpio";
		linux,phandle = <0x9f>;
		phandle = <0x9f>;
	};

	flashlights_sy7803 {
		compatible = "mediatek,flashlights_sy7803";
		linux,phandle = <0xa0>;
		phandle = <0xa0>;
	};

	flashlights_mt6370 {
		compatible = "mediatek,flashlights_mt6370";
		decouple = <0x00>;
		linux,phandle = <0xa1>;
		phandle = <0xa1>;

		channel@1 {
			type = <0x00>;
			ct = <0x00>;
			part = <0x00>;
		};

		channel@2 {
			type = <0x00>;
			ct = <0x01>;
			part = <0x00>;
		};
	};

	gps {
		compatible = "mediatek,gps";
	};

	ccu@1a0b0000 {
		compatible = "mediatek,ccu";
		reg = <0x00 0x1a0b1000 0x00 0x1000>;
		interrupts = <0x00 0xf6 0x08>;
		clocks = <0x43 0x08>;
		clock-names = "CCU_CLK_CAM_CCU";
	};

	mt_charger {
		compatible = "mediatek,mt-charger";
		linux,phandle = <0xa2>;
		phandle = <0xa2>;
	};

	thermal-message {
		linux,phandle = <0xa3>;
		phandle = <0xa3>;
	};

	lk_charger {
		compatible = "mediatek,lk_charger";
		enable_anime;
		power_path_support;
		max_charger_voltage = <0x632ea0>;
		fast_charge_voltage = <0x2dc6c0>;
		usb_charger_current = <0x7a120>;
		ac_charger_current = <0x16e360>;
		ac_charger_input_current = <0x30d400>;
		non_std_ac_charger_current = <0xf9060>;
		charging_host_charger_current = <0x16e360>;
		ta_ac_charger_current = <0x2dc6c0>;
		pd_charger_current = <0x7a120>;
		temp_t4_threshold = <0x32>;
		temp_t3_threshold = <0x2d>;
		temp_t1_threshold = <0x00>;
		linux,phandle = <0xa4>;
		phandle = <0xa4>;
	};

	charger {
		compatible = "mediatek,charger";
		algorithm_name = "SwitchCharging";
		enable_sw_jeita;
		power_path_support;
		disable_pd_dual;
		battery_cv = <0x42a680>;
		max_charger_voltage = <0x632ea0>;
		min_charger_voltage = <0x4371a0>;
		min_charger_voltage_1 = <0x4371a0>;
		min_charger_voltage_2 = <0x401640>;
		max_dmivr_charger_current = <0x155cc0>;
		usb_charger_current_suspend = <0x00>;
		usb_charger_current_unconfigured = <0x11170>;
		usb_charger_current_configured = <0x7a120>;
		usb_charger_current = <0x7a120>;
		ac_charger_current = <0x1f4000>;
		ac_charger_input_current = <0x2143a0>;
		non_std_ac_charger_current = <0xf9060>;
		charging_host_charger_current = <0x16e360>;
		apple_1_0a_charger_current = <0x9eb10>;
		apple_2_1a_charger_current = <0xc3500>;
		ta_ac_charger_current = <0x2dc6c0>;
		jeita_temp_above_t4_cv = <0x40b280>;
		jeita_temp_t3_to_t4_cv = <0x40b280>;
		jeita_temp_t2_to_t3_cv = <0x4371a0>;
		jeita_temp_t1_to_t2_cv = <0x4371a0>;
		jeita_temp_t0_to_t1_cv = <0x4371a0>;
		jeita_temp_below_t0_cv = <0x4371a0>;
		jeita_current_t3_to_t4 = <0x1f4000>;
		jeita_current_t2_to_t3 = <0x1f4000>;
		jeita_current_t1_to_t2 = <0x16e360>;
		jeita_current_t0_to_t1 = <0x83d60>;
		temp_t4_thres = <0x3c>;
		temp_t4_thres_minus_x_degree = <0x3b>;
		temp_t3_thres = <0x32>;
		temp_t3_thres_minus_x_degree = <0x31>;
		temp_t2_thres = <0x0f>;
		temp_t2_thres_plus_x_degree = <0x10>;
		temp_t1_thres = <0x0a>;
		temp_t1_thres_plus_x_degree = <0x0b>;
		temp_t0_thres = <0x00>;
		temp_t0_thres_plus_x_degree = <0x01>;
		temp_neg_10_thres = <0x00>;
		enable_min_charge_temp;
		min_charge_temp = <0x00>;
		min_charge_temp_plus_x_degree = <0x06>;
		max_charge_temp = <0x32>;
		max_charge_temp_minus_x_degree = <0x2f>;
		ta_12v_support;
		ta_9v_support;
		pe_ichg_level_threshold = <0xf4240>;
		ta_ac_12v_input_current = <0x30d400>;
		ta_ac_9v_input_current = <0x30d400>;
		ta_ac_7v_input_current = <0x30d400>;
		pe20_ichg_level_threshold = <0xf4240>;
		ta_start_battery_soc = <0x00>;
		ta_stop_battery_soc = <0x55>;
		high_temp_to_leave_pe40 = <0x2e>;
		high_temp_to_enter_pe40 = <0x27>;
		low_temp_to_leave_pe40 = <0x0a>;
		low_temp_to_enter_pe40 = <0x10>;
		pe40_single_charger_input_current = <0x2dc6c0>;
		pe40_single_charger_current = <0x2dc6c0>;
		pe40_dual_charger_input_current = <0x2dc6c0>;
		pe40_dual_charger_chg1_current = <0x1e8480>;
		pe40_dual_charger_chg2_current = <0x1e8480>;
		pe40_stop_battery_soc = <0x50>;
		pe40_r_cable_1a_lower = <0x229>;
		pe40_r_cable_2a_lower = <0x19f>;
		pe40_r_cable_3a_lower = <0x113>;
		chg1_ta_ac_charger_current = <0x16e360>;
		chg2_ta_ac_charger_current = <0x16e360>;
		slave_mivr_diff = <0x186a0>;
		dual_polling_ieoc = <0x6ddd0>;
		cable_imp_threshold = <0x2bb>;
		vbat_cable_imp_threshold = <0x3b8260>;
		bif_threshold1 = <0x40d990>;
		bif_threshold2 = <0x419ce0>;
		bif_cv_under_threshold2 = <0x43e6d0>;
		pd_vbus_low_bound = <0x4c4b40>;
		pd_vbus_upper_bound = <0x4c4b40>;
		pd_ichg_level_threshold = <0xf4240>;
		pd_stop_battery_soc = <0x50>;
		ibus_err = <0x0e>;
		vsys_watt = <0x4c4b40>;
		linux,phandle = <0xa5>;
		phandle = <0xa5>;
	};

	pd_adapter {
		compatible = "mediatek,pd_adapter";
		adapter_name = "pd_adapter";
		linux,phandle = <0xa6>;
		phandle = <0xa6>;
	};

	bq2560x {
		compatible = "ti,bq2560x_charger";
		linux,phandle = <0xa7>;
		phandle = <0xa7>;
	};

	cx7601 {
		compatible = "cx,cx7601_charger";
		linux,phandle = <0xa8>;
		phandle = <0xa8>;
	};

	rt9465_slave_chr {
		compatible = "richtek,rt9465";
		status = "disabled";
		linux,phandle = <0xa9>;
		phandle = <0xa9>;
	};

	rt-pd-manager {
		compatible = "mediatek,rt-pd-manager";
	};

	mt6370_pmu_eint {
		linux,phandle = <0xaa>;
		phandle = <0xaa>;
	};

	mt6370_pd_eint {
		linux,phandle = <0xab>;
		phandle = <0xab>;
	};

	irtx_pwm {
		compatible = "mediatek,irtx-pwm";
		pwm_ch = <0x00>;
		pwm_data_invert = <0x00>;
		linux,phandle = <0xac>;
		phandle = <0xac>;
	};

	odm {
		compatible = "simple-bus";
		linux,phandle = <0xad>;
		phandle = <0xad>;
	};

	memory-ssmr-features {
		compatible = "mediatek,memory-ssmr-features";
		svp-size = <0x00 0x10000000>;
		iris-recognition-size = <0x00 0x10000000>;
		2d_fr-size = <0x00 0x8000000>;
		tui-size = <0x00 0x4000000>;
		wfd-size = <0x00 0x4000000>;
		prot-sharedmem-size = <0x00 0x8000000>;
		ta-elf-size = <0x00 0x1000000>;
		ta-stack-heap-size = <0x00 0x6000000>;
		sdsp-tee-sharedmem-size = <0x00 0x1000000>;
		sdsp-firmware-size = <0x00 0x1000000>;
		linux,phandle = <0xae>;
		phandle = <0xae>;
	};

	audio_snd_card {
		compatible = "mediatek,audio_snd_card";
	};

	mt_soc_deep_buffer_dl_pcm {
		compatible = "mediatek,mt_soc_pcm_deep_buffer_dl";
	};

	mt_soc_ul1_pcm {
		compatible = "mediatek,mt_soc_pcm_capture";
	};

	mt_soc_voice_md1 {
		compatible = "mediatek,mt_soc_pcm_voice_md1";
	};

	mt_soc_uldlloopback_pcm {
		compatible = "mediatek,mt_soc_pcm_uldlloopback";
	};

	mt_soc_i2s0_pcm {
		compatible = "mediatek,mt_soc_pcm_dl1_i2s0";
	};

	mt_soc_mrgrx_pcm {
		compatible = "mediatek,mt_soc_pcm_mrgrx";
	};

	mt_soc_mrgrx_awb_pcm {
		compatible = "mediatek,mt_soc_pcm_mrgrx_awb";
	};

	mt_soc_fm_i2s_pcm {
		compatible = "mediatek,mt_soc_pcm_fm_i2s";
	};

	mt_soc_fm_i2s_awb_pcm {
		compatible = "mediatek,mt_soc_pcm_fm_i2s_awb";
	};

	mt_soc_i2s0dl1_pcm {
		compatible = "mediatek,mt_soc_pcm_dl1_i2s0dl1";
	};

	mt_soc_dl1_awb_pcm {
		compatible = "mediatek,mt_soc_pcm_dl1_awb";
	};

	mt_soc_voice_md1_bt {
		compatible = "mediatek,mt_soc_pcm_voice_md1_bt";
	};

	mt_soc_voip_bt_out {
		compatible = "mediatek,mt_soc_pcm_dl1_bt";
	};

	mt_soc_voip_bt_in {
		compatible = "mediatek,mt_soc_pcm_bt_dai";
	};

	mt_soc_tdmrx_pcm {
		compatible = "mediatek,mt_soc_tdm_capture";
	};

	mt_soc_fm_mrgtx_pcm {
		compatible = "mediatek,mt_soc_pcm_fmtx";
	};

	mt_soc_ul2_pcm {
		compatible = "mediatek,mt_soc_pcm_capture2";
	};

	mt_soc_i2s0_awb_pcm {
		compatible = "mediatek,mt_soc_pcm_i2s0_awb";
	};

	mt_soc_voice_md2 {
		compatible = "mediatek,mt_soc_pcm_voice_md2";
	};

	mt_soc_pcm_dl1_scp_spk {
		compatible = "mediatek,mt_soc_pcm_dl1_scp_spk";
	};

	mt_soc_pcm_voice_scp {
		compatible = "mediatek,mt_soc_pcm_voice_scp";
	};

	mt_soc_routing_pcm {
		compatible = "mediatek,mt_soc_pcm_routing";
	};

	mt_soc_voice_md2_bt {
		compatible = "mediatek,mt_soc_pcm_voice_md2_bt";
	};

	mt_soc_hp_impedance_pcm {
		compatible = "mediatek,mt_soc_pcm_hp_impedance";
	};

	mt_soc_codec_name {
		compatible = "mediatek,mt_soc_codec_63xx";
		use_hp_depop_flow = <0x00>;
		use_ul_260k = <0x00>;
	};

	mt_soc_dummy_pcm {
		compatible = "mediatek,mt_soc_pcm_dummy";
	};

	mt_soc_codec_dummy_name {
		compatible = "mediatek,mt_soc_codec_dummy";
	};

	mt_soc_routing_dai_name {
		compatible = "mediatek,mt_soc_dai_routing";
	};

	mt_soc_dai_name {
		compatible = "mediatek,mt_soc_dai_stub";
	};

	mt_soc_dl2_pcm {
		compatible = "mediatek,mt_soc_pcm_dl2";
	};

	mt_soc_anc_pcm {
		compatible = "mediatek,mt_soc_pcm_anc";
	};

	mt_soc_pcm_voice_ultra {
		compatible = "mediatek,mt_soc_pcm_voice_ultra";
	};

	mt_soc_pcm_voice_usb {
		compatible = "mediatek,mt_soc_pcm_voice_usb";
	};

	mt_soc_pcm_voice_usb_echoref {
		compatible = "mediatek,mt_soc_pcm_voice_usb_echoref";
	};

	pmic_clock_buffer_ctrl {
		compatible = "mediatek,pmic_clock_buffer";
		mediatek,clkbuf-quantity = <0x07>;
		mediatek,clkbuf-config = <0x02 0x01 0x01 0x02 0x00 0x00 0x00>;
		mediatek,clkbuf-driving-current = <0x01 0x01 0x01 0x01 0x01 0x01 0x01>;
		linux,phandle = <0xaf>;
		phandle = <0xaf>;
	};

	i2c7 {
		linux,phandle = <0xb0>;
		phandle = <0xb0>;
	};

	i2c8 {
		linux,phandle = <0xb1>;
		phandle = <0xb1>;
	};

	i2c9 {
		linux,phandle = <0xb2>;
		phandle = <0xb2>;
	};

	smart_pa {
		linux,phandle = <0xb3>;
		phandle = <0xb3>;
	};

	md1_sim1_hot_plug_eint {
		linux,phandle = <0xb4>;
		phandle = <0xb4>;
	};

	md1_sim2_hot_plug_eint {
		linux,phandle = <0xb5>;
		phandle = <0xb5>;
	};

	pseudo_m4u {
		compatible = "mediatek,mt-pseudo_m4u";
		iommus = <0x4b 0x02>;
	};

	pseudo_m4u-larb0 {
		compatible = "mediatek,mt-pseudo_m4u-port";
		mediatek,larbid = <0x00>;
		iommus = <0x4b 0x00 0x4b 0x01 0x4b 0x02 0x4b 0x03 0x4b 0x04 0x4b 0x05 0x4b 0x06 0x4b 0x07>;
	};

	pseudo_m4u-larb1 {
		compatible = "mediatek,mt-pseudo_m4u-port";
		mediatek,larbid = <0x01>;
		iommus = <0x4b 0x20 0x4b 0x21>;
	};

	pseudo_m4u-larb2 {
		compatible = "mediatek,mt-pseudo_m4u-port";
		mediatek,larbid = <0x02>;
		iommus = <0x4b 0x40 0x4b 0x41>;
	};

	pseudo_m4u-larb3 {
		compatible = "mediatek,mt-pseudo_m4u-port";
		mediatek,larbid = <0x03>;
		iommus = <0x4b 0x60 0x4b 0x61>;
	};

	eas {
		eff_turn_point = <0x1d3>;
		tiny = <0x32>;
	};

	radio_md_cfg {
		compatible = "mediatek,radio_md_cfg";
		linux,phandle = <0xb6>;
		phandle = <0xb6>;
	};

	dynamic_options {
		compatible = "mediatek,dynamic_options";
		linux,phandle = <0xb7>;
		phandle = <0xb7>;
	};

	mt6370_pmu_dts {
		interrupt-controller;
		#interrupt-cells = <0x01>;
		mt6370,intr_gpio_num = <0x03>;
		mt6370,intr_gpio = <0x20 0x03 0x00>;
		linux,phandle = <0xb8>;
		phandle = <0xb8>;

		core {
			compatible = "mediatek,mt6370_pmu_core";
			interrupt-names = "otp\0vdda_ovp\0vdda_uv";
			i2cstmr_rst_tmr = <0x00>;
			mrstb_en;
			mrstb_tmr = <0x03>;
			int_wdt = <0x00>;
			int_deg = <0x00>;
		};

		charger {
			compatible = "mediatek,mt6370_pmu_charger";
			interrupt-names = "chg_mivr\0chg_aiclmeasi\0attachi\0ovpctrl_uvp_d_evt\0chg_wdtmri\0chg_vbusov\0chg_tmri\0chg_treg";
			charger_name = "primary_chg";
			load_switch_name = "primary_load_switch";
			ichg = <0x1e8480>;
			aicr = <0x7a120>;
			mivr = <0x432380>;
			cv = <0x426030>;
			ieoc = <0x249f0>;
			safety_timer = <0x0c>;
			dc_wdt = <0x3d0900>;
			ircmp_resistor = <0x61a8>;
			ircmp_vclamp = <0x7d00>;
			enable_te;
			enable_wdt;
		};

		mt6370_pmu_fled1 {
			compatible = "mediatek,mt6370_pmu_fled1";
			interrupt-names = "fled_lvf\0fled2_short\0fled1_short";
			fled_enable = <0x01>;
			torch_cur = <0x493e0>;
			strobe_cur = <0x124f80>;
			strobe_timeout = <0x960>;
		};

		mt6370_pmu_fled2 {
			compatible = "mediatek,mt6370_pmu_fled2";
			fled_enable = <0x01>;
			torch_cur = <0x30d40>;
			strobe_cur = <0xf4240>;
			strobe_timeout = <0x4b0>;
		};

		ldo {
			compatible = "mediatek,mt6370_pmu_ldo";
			interrupt-names = "ldo_oc";
			ldo_oms = <0x01>;
			ldo_vrc_lt = <0x01>;

			mt6370_ldo {
				regulator-name = "irtx_ldo";
				regulator-min-microvolt = <0x186a00>;
				regulator-max-microvolt = <0x3d0900>;
			};
		};

		rgbled {
			compatible = "mediatek,mt6370_pmu_rgbled";
			interrupt-names = "isink4_short\0isink3_short\0isink2_short\0isink1_short\0isink4_open\0isink3_open\0isink2_open\0isink1_open";
			mt,led_name = "mt6370_pmu_led1\0mt6370_pmu_led2\0mt6370_pmu_led3\0mt6370_pmu_led4";
			mt,led_default_trigger = "cc_mode\0cc_mode\0cc_mode\0none";
		};

		bled {
			compatible = "mediatek,mt6370_pmu_bled";
			interrupt-names = "bled_ocp";
			mt,bled_name = "mt6370_pmu_bled";
			mt,chan_en = <0x0f>;
			mt,map_linear;
			mt,bl_ovp_level = <0x03>;
			mt,bl_ocp_level = <0x02>;
			mt,use_pwm;
			mt,pwm_fsample = <0x02>;
			mt,pwm_deglitch = <0x01>;
			mt,pwm_hys_en = <0x01>;
			mt,pwm_hys = <0x00>;
			mt,pwm_avg_cycle = <0x00>;
			mt,bled_ramptime = <0x03>;
			mt,bled_flash_ramp = <0x01>;
			mt,max_bled_brightness = <0x200>;
		};

		dsv {
			compatible = "mediatek,mt6370_pmu_dsv";
			interrupt-names = "dsv_vneg_ocp\0dsv_vpos_ocp\0dsv_bst_ocp\0dsv_vneg_scp\0dsv_vpos_scp";
			db_ext_en = <0x00>;
			db_periodic_fix = <0x00>;
			db_single_pin = <0x00>;
			db_freq_pm = <0x00>;
			db_periodic_mode = <0x00>;
			db_startup = <0x00>;
			db_vneg_20ms = <0x01>;
			db_vneg_disc = <0x00>;
			db_vpos_20ms = <0x01>;
			db_vpos_disc = <0x01>;
			db_delay = <0x03>;
			db_vbst = <0x1644>;
			db_vpos_slew = <0x01>;
			db_vneg_slew = <0x01>;

			mt6370_dsvp {
				regulator-name = "dsv_pos";
				regulator-min-microvolt = <0x3d0900>;
				regulator-max-microvolt = <0x5b8d80>;
			};

			mt6370_dsvn {
				regulator-name = "dsv_neg";
				regulator-min-microvolt = <0x3d0900>;
				regulator-max-microvolt = <0x5b8d80>;
			};
		};
	};

	type_c_port0 {
		tcpc-dual,supported_modes = <0x00>;
		mt-tcpc,name = "type_c_port0";
		mt-tcpc,role_def = <0x04>;
		mt-tcpc,rp_level = <0x00>;
		mt-tcpc,vconn_supply = <0x01>;
		mt6370pd,intr_gpio = <0x20 0x18 0x00>;
		mt6370pd,intr_gpio_num = <0x18>;
		linux,phandle = <0xb9>;
		phandle = <0xb9>;

		pd-data {
			pd,vid = <0x29cf>;
			pd,pid = <0x5081>;
			pd,source-cap-ext = <0x171129cf 0x00 0x102 0x00 0x00 0x2000000>;
			pd,mfrs = "RichtekTCPC";
			pd,charging_policy = <0x21>;
			pd,source-pdo-size = <0x01>;
			pd,source-pdo-data = <0x19032>;
			pd,sink-pdo-size = <0x02>;
			pd,sink-pdo-data = <0x190c8 0xc0761e3c>;
			pd,id-vdo-size = <0x03>;
			pd,id-vdo-data = <0xd10029cf 0x00 0x10000>;
			bat,nr = <0x01>;
			pd,country_nr = <0x00>;

			bat-info0 {
				bat,vid = <0x29cf>;
				bat,pid = <0x1711>;
				bat,mfrs = "bat1";
				bat,design_cap = <0xbb8>;
			};
		};

		dpm_caps {
			local_dr_power;
			local_dr_data;
			local_usb_comm;
			local_no_suspend;
			local_vconn_supply;
			attemp_enter_dp_mode;
			attemp_discover_cable;
			attemp_discover_id;
			pr_check = <0x00>;
			pr_check_gp_source;
			dr_check = <0x00>;
		};
	};

	__symbols__ {
		chosen = "/chosen";
		cpu0 = "/cpus/cpu@000";
		cpu1 = "/cpus/cpu@001";
		cpu2 = "/cpus/cpu@002";
		cpu3 = "/cpus/cpu@003";
		cpu4 = "/cpus/cpu@100";
		cpu5 = "/cpus/cpu@101";
		cpu6 = "/cpus/cpu@102";
		cpu7 = "/cpus/cpu@103";
		STANDBY = "/cpus/idle-states/standby";
		MCDI_CPU = "/cpus/idle-states/mcdi-cpu";
		MCDI_CLUSTER = "/cpus/idle-states/mcdi-cluster";
		SODI = "/cpus/idle-states/sodi";
		SODI3 = "/cpus/idle-states/sodi3";
		DPIDLE = "/cpus/idle-states/dpidle";
		SUSPEND = "/cpus/idle-states/suspend";
		reserved_memory = "/reserved-memory";
		cpu_dbgapb = "/cpu_dbgapb@0d410000";
		gic = "/interrupt-controller@0c000000";
		sysirq = "/intpol-controller@10200a80";
		infracfg_ao = "/infracfg_ao@10001000";
		scpsys = "/scpsys@10001000";
		topckgen = "/topckgen@10000000";
		syscfg_pctl_1 = "/syscfg_pctl_1@0x10002000";
		syscfg_pctl_2 = "/syscfg_pctl_2@0x10002200";
		syscfg_pctl_3 = "/syscfg_pctl_3@0x10002400";
		syscfg_pctl_4 = "/syscfg_pctl_4@0x10002600";
		syscfg_pctl_5 = "/syscfg_pctl_5@0x10002800";
		syscfg_pctl_6 = "/syscfg_pctl_6@0x10002a00";
		syscfg_pctl_7 = "/syscfg_pctl_7@0x10002c00";
		pericfg = "/pericfg@10003000";
		gpio_usage_mapping = "/gpio";
		gpio = "/gpio@10005000";
		syscfg_pctl_0 = "/syscfg_pctl_0@10005000";
		pio = "/pinctrl@1000b000";
		msdc0_pins_default = "/pinctrl@1000b000/msdc0@default";
		msdc0_pins_hs400 = "/pinctrl@1000b000/msdc0@hs400";
		msdc0_pins_hs200 = "/pinctrl@1000b000/msdc0@hs200";
		msdc0_register_setting_default = "/pinctrl@1000b000/msdc0@register_default";
		msdc1_pins_default = "/pinctrl@1000b000/msdc1@default";
		msdc1_pins_sdr104 = "/pinctrl@1000b000/msdc1@sdr104";
		msdc1_pins_sdr50 = "/pinctrl@1000b000/msdc1@sdr50";
		msdc1_pins_ddr50 = "/pinctrl@1000b000/msdc1@ddr50";
		msdc1_register_setting_default = "/pinctrl@1000b000/msdc1@register_default";
		msdc3_pins_default = "/pinctrl@1000b000/msdc3@default";
		msdc3_register_setting_default = "/pinctrl@1000b000/msdc3@register_default";
		clk26m = "/clocks/clk26m";
		clk32k = "/clocks/clk32k";
		apmixed = "/apmixed@1000c000";
		main_pmic = "/mt-pmic";
		pmic_auxadc = "/mt-pmic/mt635x-auxadc";
		mt_pmic_vs1_buck_reg = "/mt-pmic/buck_regulators/buck_vs1";
		mt_pmic_vmodem_buck_reg = "/mt-pmic/buck_regulators/buck_vmodem";
		mt_pmic_vcore_buck_reg = "/mt-pmic/buck_regulators/buck_vcore";
		mt_pmic_vproc_buck_reg = "/mt-pmic/buck_regulators/buck_vproc";
		mt_pmic_vpa_buck_reg = "/mt-pmic/buck_regulators/buck_vpa";
		mt_pmic_vfe28_ldo_reg = "/mt-pmic/ldo_regulators/ldo_vfe28";
		mt_pmic_vxo22_ldo_reg = "/mt-pmic/ldo_regulators/ldo_vxo22";
		mt_pmic_vrf18_ldo_reg = "/mt-pmic/ldo_regulators/ldo_vrf18";
		mt_pmic_vrf12_ldo_reg = "/mt-pmic/ldo_regulators/ldo_vrf12";
		mt_pmic_vefuse_ldo_reg = "/mt-pmic/ldo_regulators/ldo_vefuse";
		mt_pmic_vcn33_bt_ldo_reg = "/mt-pmic/ldo_regulators/ldo_vcn33_bt";
		mt_pmic_vcn33_wifi_ldo_reg = "/mt-pmic/ldo_regulators/ldo_vcn33_wifi";
		mt_pmic_vcn28_ldo_reg = "/mt-pmic/ldo_regulators/ldo_vcn28";
		mt_pmic_vcn18_ldo_reg = "/mt-pmic/ldo_regulators/ldo_vcn18";
		mt_pmic_vcama_ldo_reg = "/mt-pmic/ldo_regulators/ldo_vcama";
		mt_pmic_vcamd_ldo_reg = "/mt-pmic/ldo_regulators/ldo_vcamd";
		mt_pmic_vcamio_ldo_reg = "/mt-pmic/ldo_regulators/ldo_vcamio";
		mt_pmic_vldo28_ldo_reg = "/mt-pmic/ldo_regulators/ldo_vldo28";
		mt_pmic_vsram_others_ldo_reg = "/mt-pmic/ldo_regulators/ldo_vsram_others";
		mt_pmic_vsram_proc_ldo_reg = "/mt-pmic/ldo_regulators/ldo_vsram_proc";
		mt_pmic_vaux18_ldo_reg = "/mt-pmic/ldo_regulators/ldo_vaux18";
		mt_pmic_vaud28_ldo_reg = "/mt-pmic/ldo_regulators/ldo_vaud28";
		mt_pmic_vio28_ldo_reg = "/mt-pmic/ldo_regulators/ldo_vio28";
		mt_pmic_vio18_ldo_reg = "/mt-pmic/ldo_regulators/ldo_vio18";
		mt_pmic_vdram_ldo_reg = "/mt-pmic/ldo_regulators/ldo_vdram";
		mt_pmic_vmc_ldo_reg = "/mt-pmic/ldo_regulators/ldo_vmc";
		mt_pmic_vmch_ldo_reg = "/mt-pmic/ldo_regulators/ldo_vmch";
		mt_pmic_vemc_ldo_reg = "/mt-pmic/ldo_regulators/ldo_vemc";
		mt_pmic_vsim1_ldo_reg = "/mt-pmic/ldo_regulators/ldo_vsim1";
		mt_pmic_vsim2_ldo_reg = "/mt-pmic/ldo_regulators/ldo_vsim2";
		mt_pmic_vibr_ldo_reg = "/mt-pmic/ldo_regulators/ldo_vibr";
		mt_pmic_vusb33_ldo_reg = "/mt-pmic/ldo_regulators/ldo_vusb33";
		keypad = "/kp@10010000";
		otg_iddig = "/otg_iddig";
		mrdump_ext_rst = "/mrdump_ext_rst";
		touch = "/touch";
		accdet = "/accdet";
		goodix_fp = "/fingerprint";
		fpsensor_fp_eint = "/fpsensor_fp_eint";
		fpsensor_finger = "/fpsensor_finger";
		chr_stat = "/chr_stat";
		swtp = "/swtp";
		swtp1 = "/swtp1";
		bat_gm30 = "/battery";
		iommu = "/m4u@10205000";
		mdcldma = "/mdcldma@10014000";
		gce = "/gce@10238000";
		gce_mbox = "/gce_mbox@10238000";
		gce_mbox_svp = "/gce_mbox_svp@10238000";
		auxadc = "/auxadc@11001000";
		apdma = "/dma-controller@11000580";
		uart0 = "/serial@11020000";
		uart1 = "/serial@11030000";
		i2c_common = "/i2c_common";
		i2c0 = "/i2c0@11007000";
		i2c1 = "/i2c1@11008000";
		i2c2 = "/i2c2@11009000";
		i2c3 = "/i2c3@1100f000";
		i2c4 = "/i2c4@11011000";
		i2c5 = "/i2c5@11016000";
		i2c6 = "/i2c6@1100d000";
		pwm = "/pwm@11006000";
		spi0 = "/spi@1100a000";
		consys = "/consys@18002000";
		spi1 = "/spi@11010000";
		spi2 = "/spi@11012000";
		spi3 = "/spi@11013000";
		spi4 = "/spi@11014000";
		spi5 = "/spi@11015000";
		msdc0 = "/msdc@11230000";
		msdc1 = "/msdc@11240000";
		msdc2 = "/msdc@11250000";
		msdc3 = "/msdc@11260000";
		msdc1_ins = "/msdc1_ins@0";
		audio = "/audio@11220000";
		audgpio = "/mt_soc_dl1_pcm@11220000";
		btcvsd_snd = "/mtk-btcvsd-snd@18050000";
		mipi_rx_ana_csi0a = "/mipi_rx_ana_csi0a@11c10000";
		mipi_rx_ana_csi0b = "/mipi_rx_ana_csi0b@11c11000";
		mipi_rx_ana_csi1a = "/mipi_rx_ana_csi1a@11c12000";
		mipi_rx_ana_csi1b = "/mipi_rx_ana_csi1b@11c13000";
		mipi_rx_ana_csi2a = "/mipi_rx_ana_csi2a@11c14000";
		mipi_rx_ana_csi2b = "/mipi_rx_ana_csi2b@11c15000";
		mfg_cfg = "/mfg_cfg@13ffe000";
		mmsys_config = "/mmsys_config@14000000";
		nfc = "/nfc";
		irq_nfc = "/irq_nfc";
		disp_mutex0 = "/disp_mutex0@14001000";
		imgsys = "/imgsys@15020000";
		smi_larb0 = "/smi_larb0@14003000";
		mdp_rdma0 = "/mdp_rdma0@14004000";
		mdp_ccorr = "/mdp_ccorr0@14005000";
		mdp_rsz0 = "/mdp_rsz0@14006000";
		mdp_rsz1 = "/mdp_rsz1@14007000";
		mdp_wdma0 = "/mdp_wdma0@14008000";
		mdp_wrot0 = "/mdp_wrot0@14009000";
		mdp_tdshp0 = "/mdp_tdshp0@1400a000";
		disp_color0 = "/disp_color0@1400f000";
		mtkfb = "/mtkfb@0";
		dsi_te = "/dsi_te";
		smi_larb2 = "/smi_larb2@15021000";
		venc_gcon = "/venc_gcon@17000000";
		smi_larb1 = "/smi_larb1@17010000";
		camsys = "/camsys@1a000000";
		smi_larb3 = "/smi_larb3@1a002000";
		kd_camera_hw1 = "/kd_camera_hw1@1a040000";
		flashlight_core = "/flashlight_core";
		flashlights_dummy_gpio = "/flashlights_dummy_gpio";
		flashlights_sy7803 = "/flashlights_sy7803";
		flashlights_mt6370 = "/flashlights_mt6370";
		mt_charger = "/mt_charger";
		thermal_message = "/thermal-message";
		lk_charger = "/lk_charger";
		charger = "/charger";
		pd_adapter = "/pd_adapter";
		bq2560x = "/bq2560x";
		cx7601 = "/cx7601";
		rt9465_slave_chr = "/rt9465_slave_chr";
		subpmic_pmu_eint = "/mt6370_pmu_eint";
		tcpc_pd = "/mt6370_pd_eint";
		irtx_pwm = "/irtx_pwm";
		odm = "/odm";
		memory_ssmr_features = "/memory-ssmr-features";
		pmic_clock_buffer_ctrl = "/pmic_clock_buffer_ctrl";
		i2c7 = "/i2c7";
		i2c8 = "/i2c8";
		i2c9 = "/i2c9";
		smart_pa = "/smart_pa";
		md1_sim1_hot_plug_eint = "/md1_sim1_hot_plug_eint";
		md1_sim2_hot_plug_eint = "/md1_sim2_hot_plug_eint";
		radio_md_cfg = "/radio_md_cfg";
		dynamic_options = "/dynamic_options";
		mt6370_pmu = "/mt6370_pmu_dts";
		mt6370_typec = "/type_c_port0";
	};
};
